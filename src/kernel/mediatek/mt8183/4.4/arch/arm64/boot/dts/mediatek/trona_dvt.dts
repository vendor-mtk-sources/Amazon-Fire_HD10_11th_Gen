/*
 * Copyright (C) 2018 MediaTek Inc.
 *
 * This program is free software; you can redistribute it and/or modify
 * it under the terms of the GNU General Public License version 2 as
 * published by the Free Software Foundation.
 *
 * This program is distributed in the hope that it will be useful,
 * but WITHOUT ANY WARRANTY; without even the implied warranty of
 * MERCHANTABILITY or FITNESS FOR A PARTICULAR PURPOSE.  See the
 * GNU General Public License for more details.
 */

#include "mt8183.dts"
#include <trona/cust.dtsi>

/ {
	version = "dvt";
};

/* chosen */
&chosen {
	/* fpga may has no lk, we need to specify display info here */
	/* fb buffer is reserved using this dts by memory node above */

	atag,videolfb-fb_base_l = <0x5e605000>;
	atag,videolfb-fb_base_h = <0x0>;
	atag,videolfb-islcmfound = <1>;
	atag,videolfb-islcm_inited = <0>;
	atag,videolfb-fps= <6000>;
	atag,videolfb-vramSize= <0x017bb000>;
	atag,videolfb-lcmname= "ft8201_wuxga_dsi_vdo";
};

&odm {
	led0:led@0 {
		compatible = "mediatek,red";
		led_mode = <0>;
		data = <1>;
		pwm_config = <0 0 0 0 0>;
	};
	led1:led@1 {
		compatible = "mediatek,green";
		led_mode = <0>;
		data = <1>;
		pwm_config = <0 0 0 0 0>;
	};
	led2:led@2 {
		compatible = "mediatek,blue";
		led_mode = <0>;
		data = <1>;
		pwm_config = <0 0 0 0 0>;
	};
	led3:led@3 {
		compatible = "mediatek,jogball-backlight";
		led_mode = <0>;
		data = <1>;
		pwm_config = <0 0 0 0 0>;
	};
	led4:led@4 {
		compatible = "mediatek,keyboard-backlight";
		led_mode = <0>;
		data = <1>;
		pwm_config = <0 0 0 0 0>;
	};
	led5:led@5 {
		compatible = "mediatek,button-backlight";
		led_mode = <0>;
		data = <1>;
		pwm_config = <0 0 0 0 0>;
	};
	led6:led@6 {
		compatible = "mediatek,lcd-backlight";
		led_mode = <3>;
		data = <1>;
		pwm_config = <0 1 0 0 0>;
	};
	lcm_common_resource:lcm_common_resource {
		lcm_rst_gpio = <&pio 45 0>;
		tp_rst_gpio = <&pio 2 0>;
	};
	lcm0:lcm@0 {
		compatible = "focal,ft8201";
		lcm_common_resource = <&lcm_common_resource>;
		lcm_common_vcc1v8-supply = <&mt_pmic_vrf18_ldo_reg>;
		pinctrl-names = "default";
		pinctrl-0 = <&lcm_gpio_defalut_cfg>;
		status = "okay";
	};
	lcm1:lcm@1 {
		compatible = "novatek,nt36523";
		lcm_common_resource = <&lcm_common_resource>;
		lcm_common_vcc1v8-supply = <&mt_pmic_vrf18_ldo_reg>;
		pinctrl-names = "default";
		pinctrl-0 = <&lcm_gpio_defalut_cfg>;
		status = "okay";
	};
	lcm2:lcm@2 {
		compatible = "focal,ft8201ab";
		lcm_common_resource = <&lcm_common_resource>;
		lcm_common_vcc1v8-supply = <&mt_pmic_vrf18_ldo_reg>;
		pinctrl-names = "default";
		pinctrl-0 = <&lcm_gpio_defalut_cfg>;
		status = "okay";
	};
	lcm_panels {
		lcm-phandle-list = <&lcm0>, <&lcm1>, <&lcm2>;
	};

	mt_pmic_customization: mt_pmic_customization@0 {
		compatible = "mediatek,mt-pmic-custom-setting";
		custom-reg = <0x112 0x0 0x1 0x1 /* RTC32k_1V8_1 Enable */
			      0x1c32 0x1 0xf 0x0 /* LDO_VRF12_OP_EN */
		>;
		disable-modem = <1>;
	};
	/* Hall Sensor */
	hall_sensor:hall {
		compatible = "hall,hall-sensor";
		interrupt-parent = <&pio>;
		interrupts = <5 IRQ_TYPE_LEVEL_LOW 5 0>;
		int-gpio = <&pio 5 0>;
		sensor-name = "hall_sensor_1";
		sensor-num = <1>;
	};

	/* amazon virtual sensor */
	#include "vs1.dtsi"
	#include "vs2.dtsi"
	#include "vs3.dtsi"
	#include "vs4.dtsi"

#ifndef CONFIG_USER_BUILD
	keycombo@0 {
		compatible = "amzn,keycombo";
		keys_down = "KEY_VOLUMEDOWN", "KEY_VOLUMEUP", "KEY_POWER";
		keys_down_delay = <5000>;
		keys_down_func = <0>;		/* panic */
		status = "okay";
	};
#endif
	keycombo@1 {
		compatible = "amzn,keycombo";
		keys_down = "KEY_POWER";
		keys_down_delay = <6000>;
		keys_down_func = <1>;		/* power off  */
		status = "okay";
	};

	amzn_rt_trace {
		compatible = "amzn,rt-trace";
		ddr@0 {
			type = <0>;
			trace-items = <1024>;
		};
		cpu@1 {
			type = <1>;
			trace-items = <1024>;
		};
	};

	keysilent-ota {
		compatible = "amzn,silent-ota";
		keys_down = "KEY_POWER";
		keys_down_delay = <0>;
		status = "okay";
	};

	integrity-module {
		compatible = "amzn,integrity-module";
		status = "okay";
	};

	/* USB PHY tuning */
	usb_phy_tuning {
		compatible = "mediatek,phy_tuning";
		u2_vrt_ref = <7>;
		u2_term_ref = <6>;
	};
	/* USB PHY tuning end */

	rfc_id {
		compatible = "mediatek,rfc_id_pin";
		rfc_id_pin = <&pio 177 0>;
		pinctrl-names = "default";
		pinctrl-0 = <&rfc_id_pin0_default>;
	};

	ffc_id {
		compatible = "mediatek,ffc_id_pin";
		ffc_id_pin = <&pio 176 0>;
		pinctrl-names = "default";
		pinctrl-0 = <&ffc_id_pin1_default>;
	};

	liquid_id {
		compatible = "amzn,liquid_id_pin";
		liquid_id_pin = <&pio 53 0>;
		pinctrl-names = "default";
		pinctrl-0 = <&liquid_id_pin_default>;
	};

	board_id {
		compatible = "amzn,board_id_pin";
		boardid_1 = <&pio 13 0>;
		boardid_2 = <&pio 14 0>;
		boardid_3 = <&pio 15 0>;
		pinctrl-names = "board_id_1", "board_id_2", "board_id_3";
		pinctrl-0 = <&board_id_1_default>;
		pinctrl-1 = <&board_id_2_default>;
		pinctrl-2 = <&board_id_3_default>;
	};

	adcsw3_switch_ctrl {
		compatible = "amzn,adcsw3_switch_ctrl";
		pinctrl-names = "adcsw3_init", "switch_battery_id", "switch_battery_ntc";
		pinctrl-0 = <&adcsw3_switch_init>;
		pinctrl-1 = <&adcsw3_switch_battery_id>;
		pinctrl-2 = <&adcsw3_switch_battery_ntc>;
	};
};

&pio {
	liquid_id_pin_default: liquid_id_pin_default {
		pins_cmd_dat {
			pinmux = <PINMUX_GPIO53__FUNC_GPIO53>;
			slew-rate = <0>;
			bias-disable;
		};
	};

	board_id_1_default: board_id_1 {
		pins_cmd_dat {
			pinmux = <PINMUX_GPIO13__FUNC_GPIO13>;
			slew-rate = <0>;
			bias-disable;
		};
	};


	board_id_2_default: board_id_2 {
		pins_cmd_dat {
			pinmux = <PINMUX_GPIO14__FUNC_GPIO14>;
			slew-rate = <0>;
			bias-disable;
		};
	};

	board_id_3_default: board_id_3 {
		pins_cmd_dat {
			pinmux = <PINMUX_GPIO15__FUNC_GPIO15>;
			slew-rate = <0>;
			bias-disable;
		};
	};

	/* Battery_ID|Battery_NTC SWITCH GPIO Settings */
	adcsw3_switch_init: adcsw3_init {
		pins_cmd_dat {
			pins = <PINMUX_GPIO77__FUNC_GPIO77>;
			slew-rate = <1>;
			output-low;
			bias-disable;
		};
	};

	adcsw3_switch_battery_id: switch_battery_id {
		pins_cmd_dat {
			pins = <PINMUX_GPIO77__FUNC_GPIO77>;
			slew-rate = <1>;
			output-low;
			bias-disable;
		};
	};

	adcsw3_switch_battery_ntc: switch_battery_ntc {
		pins_cmd_dat {
			pins = <PINMUX_GPIO77__FUNC_GPIO77>;
			slew-rate = <1>;
			output-high;
			bias-disable;
		};
	};
};

&pio {
	/* eMMC_NTC|WPC_NTC SWITCH GPIO Settings */
	switch_pin_default: switch_pin_default {
		switch_ntc_pin {
			pins = <PINMUX_GPIO47__FUNC_GPIO47>;
			slew-rate = <1>;
			output-low;
			bias-disable;
		};
	};

	switch_wpc_ntc: switch_wpc_ntc {
		switch_ntc_pin {
			pins = <PINMUX_GPIO47__FUNC_GPIO47>;
			slew-rate = <1>;
			output-high;
			bias-disable;
		};
	};

	switch_emmc_ntc: switch_emmc_ntc {
		switch_ntc_pin {
			pins = <PINMUX_GPIO47__FUNC_GPIO47>;
			slew-rate = <1>;
			output-low;
			bias-disable;
		};
	};
};

&pio {
	/* LCM GPIO Settings - default */
	lcm_gpio_defalut_cfg: lcm_gpio_defalut_cfg {
		pins_cmd_lcm_rst {
			pins = <PINMUX_GPIO45__FUNC_GPIO45>;
			slew-rate = <1>;
			output-high;
		};
		pins_cmd_tp_rst {
			pins = <PINMUX_GPIO2__FUNC_GPIO2>;
			slew-rate = <1>;
			output-high;
		};
	};
};

&scp {
	core_1 = "enable";
	scp_sramSize = <0x00080000>;     /* scp_A_sram_size */
};


&mt6370_pmu {
	bled {
		mt,max_bled_brightness = <1370>;
		mt,ignore_initial_bled_brightness = <1>;
	};
	dsv {
		db_delay = <2>; /* 1 = 0 ms; 2 = 1 ms; 3 = 4 ms */
		db_vbst  = <6200>; /* mV */
	};
};

/* TOUCH start */
&touch {
	tpd-resolution = <1200 1920>;
	use-tpd-button = <0>;
	tpd-key-num = <3>;
	tpd-key-local= <139 172 158 0>;
	tpd-key-dim-local = <90 883 100 40 230 883 100 40 370 883 100 40 0 0 0 0>;
	tpd-max-touch-num = <10>;
	tpd-filter-enable = <0>;
	tpd-filter-pixel-density = <146>;
	tpd-filter-custom-prameters = <0 0 0 0 0 0 0 0 0 0 0 0>;
	tpd-filter-custom-speed = <0 0 0>;
	pinctrl-names = "default", "state_eint_as_int", "state_eint_output0", "state_eint_output1",
		"state_rst_output0", "state_rst_output1";
	pinctrl-0 = <&ctp_pins_default>;
	pinctrl-1 = <&ctp_pins_eint_as_int>;
	pinctrl-2 = <&ctp_pins_eint_output0>;
	pinctrl-3 = <&ctp_pins_eint_output1>;
	pinctrl-4 = <&ctp_pins_rst_output0>;
	pinctrl-5 = <&ctp_pins_rst_output1>;
	vtouch-supply = <&mt_pmic_vldo28_ldo_reg>;
	vtouchio-supply = <&mt_pmic_vrf18_ldo_reg>;
	status = "okay";
};

&i2c0 {
	focal_touch@38 {
		compatible = "mediatek,cap_touch";
		reg = <0x38>;
		lcm_common_resource = <&lcm_common_resource>;
		lcm_common_vcc1v8-supply = <&mt_pmic_vrf18_ldo_reg>;
	};
	novatek@62 {
		compatible = "novatek,NVT-ts";
		reg = <0x62>;
		status = "ok";

		/* vdd-supply = <&pm8994_lvs2>;    //VDDIO */
		/* avdd-supply = <&pm8994_l22>;    //VDD */
		lcm_common_resource = <&lcm_common_resource>;
		lcm_common_vcc1v8-supply = <&mt_pmic_vrf18_ldo_reg>;
		/* novatek,reset-gpio = <&msm_gpio 102 0x00>; */
		novatek,irq-gpio = <&pio 1 0x00>;

		/* novatek,pen-support; */
		/* novatek,wgp-stylus; */

		/* MP */
		/* novatek,mp-support-dt; */
		/* novatek,mp-support-header; */
		novatek,mp-support-csv;
		pinctrl-names = "nvt_i2c0_suspend", "nvt_i2c0_rusume";
		pinctrl-0 = <&i2c0_pins_suspend>;
		pinctrl-1 = <&i2c0_pins_resume>;
	};
};
&pio {
	i2c0_pins_suspend: i2c0_pins_suspend {
		pins_cmd_dat {
			pinmux = <PINMUX_GPIO82__FUNC_GPIO82>,
			<PINMUX_GPIO83__FUNC_GPIO83>;
			bias-pull-down;
		};
	};

	i2c0_pins_resume: i2c0_pins_resume {
		pins_cmd_dat {
			pinmux = <PINMUX_GPIO82__FUNC_SDA0>,
			<PINMUX_GPIO83__FUNC_SCL0>;
			bias-pull-up;
		};
	};
};
&i2c2 {
		#address-cells = <1>;
		#size-cells = <0>;
		clock-frequency = <400000>;
		mediatek,use-open-drain;

		ccu_sensor_i2c_main_hw_mtk:ccu_sensor_i2c_main_hw@33 {
				compatible = "mediatek,ccu_sensor_i2c_main_hw";
				reg = <0x33>;
				status = "okay";
		};

};

&i2c4 {
		#address-cells = <1>;
		#size-cells = <0>;
		clock-frequency = <400000>;
		mediatek,use-open-drain;

		ccu_sensor_i2c_sub_hw_mtk:ccu_sensor_i2c_sub_hw@43 {
				compatible = "mediatek,ccu_sensor_i2c_sub_hw";
				reg = <0x43>;
				status = "okay";
		};

};

&pio {
	ctp_pins_default: eint0default {
		pins_cmd_dat {
			pins = <PINMUX_GPIO1__FUNC_GPIO1>;
			slew-rate = <0>;
			bias-disable;
		};
	};
	ctp_pins_eint_as_int: eint@0 {
		pins_cmd_dat {
			pins = <PINMUX_GPIO1__FUNC_GPIO1>;
			slew-rate = <0>;
			bias-disable;
		};
	};
	ctp_pins_eint_output0: eintoutput0 {
		pins_cmd_dat {
			pins = <PINMUX_GPIO1__FUNC_GPIO1>;
			slew-rate = <1>;
			output-low;
		};
	};
	ctp_pins_eint_output1: eintoutput1 {
		pins_cmd_dat {
			pins = <PINMUX_GPIO1__FUNC_GPIO1>;
			slew-rate = <1>;
			output-high;
		};
	};
	ctp_pins_rst_output0: rstoutput0 {
		pins_cmd_dat {
			pins = <PINMUX_GPIO2__FUNC_GPIO2>;
			slew-rate = <1>;
			output-low;
		};
	};
	ctp_pins_rst_output1: rstoutput1 {
		pins_cmd_dat {
			pins = <PINMUX_GPIO2__FUNC_GPIO2>;
			slew-rate = <1>;
			output-high;
		};
	};
	spi_pins_1: spi1@0{
		pins_spi{
			pinmux = <PINMUX_GPIO161__FUNC_SPI1_A_MI>,
				<PINMUX_GPIO162__FUNC_SPI1_A_CSB>,
				<PINMUX_GPIO163__FUNC_SPI1_A_MO>,
				<PINMUX_GPIO164__FUNC_SPI1_A_CLK>;
			bias-disable;
		};
	};
};
/* TOUCH end */

/* accdet start */
&accdet {
	/* accdet micbias voltage: 0x07,2.7v;0x05,2.5v;0x02,1.9v */
	accdet-mic-vol = <6>;
	headset-mode-setting = <0x500 0x500 1 0x1f0 0x800 0x800 0x20 0x44>;
	accdet-plugout-debounce = <1>;
	/*1:ACC mode, 2:low cost without in bias, 6:low cost with in bias*/
	accdet-mic-mode = <1>;
	/* eint_level_trigger: 8,LEVEL_LOW(default);4,LEVEL_HIGH;others,LEVEL_LOW */
	headset-eint-level-pol = <8>;
	/*0--MD_MAX--UP_MAX--DW_MAX*/
	headset-three-key-threshold = <0 80 220 400>;
	headset-three-key-threshold-CDD = <0 121 192 600>;
	/*0--MD_MAX--VOICE_MAX--UP_MAX--DW_MAX*/
	headset-four-key-threshold = <0 58 121 192 400>;
	/*moisture external resister ohm*/
	moisture-external-r = <2000000>;
	/*moisture internal resister ohm*/
	moisture-internal-r = <47000>;
	/*moisture of water resister ohm*/
	moisture-water-r = <10000>;
	/* ACCDET GPIO standardization ACC mode no use */
	pinctrl-names = "default", "typeswitch_off", "typeswitch_on";
	pinctrl-0 = <&accdet_pins_default>;
	pinctrl-1 = <&aud_pins_ts3a226ae_off>;
	pinctrl-2 = <&aud_pins_ts3a226ae_on>;
	status = "okay";
};
&pio {
	accdet_pins_default: accdetdefault {
		pins_cmd_dat {
			pins = <PINMUX_GPIO166__FUNC_GPIO166>;
			slew-rate = <1>;
			output-low;
		};
	};
	aud_pins_ts3a226ae_off: audts3a226aeoff@1 {
		pins_cmd_dat {
			pins = <PINMUX_GPIO166__FUNC_GPIO166>;
			slew-rate = <1>;
			output-low;
		};
	};
	aud_pins_ts3a226ae_on: audts3a226aeon@2 {
		pins_cmd_dat {
			pins = <PINMUX_GPIO166__FUNC_GPIO166>;
			slew-rate = <1>;
			output-high;
		};
	};
};
/* accdet end */

/* AUDIO GPIO standardization */
&audgpio {
	pinctrl-names = "aud_clk_mosi_off",
			"aud_clk_mosi_on",
			"aud_dat_mosi_off",
			"aud_dat_mosi_on",
			"aud_dat_miso_off",
			"aud_dat_miso_on",
			"aud_smartpa_off",
			"aud_smartpa_on",
			"vow_dat_miso_off",
			"vow_dat_miso_on",
			"vow_clk_miso_off",
			"vow_clk_miso_on",
			"ext_spk_amp_on",
			"ext_spk_amp_off",
			"ext_spk_amp_ctrl0_on",
			"ext_spk_amp_ctrl0_off",
			"ext_hp_amp_on",
			"ext_hp_amp_off",
			"ext_hp_amp_ctrl0_on",
			"ext_hp_amp_ctrl0_off",
			"ext_hp_amp_ctrl1_on",
			"ext_hp_amp_ctrl1_off";
	pinctrl-0 = <&aud_clk_mosi_off>;
	pinctrl-1 = <&aud_clk_mosi_on>;
	pinctrl-2 = <&aud_dat_mosi_off>;
	pinctrl-3 = <&aud_dat_mosi_on>;
	pinctrl-4 = <&aud_dat_miso_off>;
	pinctrl-5 = <&aud_dat_miso_on>;
	pinctrl-6 = <&aud_pins_smartpa_off>;
	pinctrl-7 = <&aud_pins_smartpa_on>;
	pinctrl-8 = <&vow_dat_miso_off>;
	pinctrl-9 = <&vow_dat_miso_on>;
	pinctrl-10 = <&vow_clk_miso_off>;
	pinctrl-11 = <&vow_clk_miso_on>;
	pinctrl-12 = <&ext_spk_amp_on>;
	pinctrl-13 = <&ext_spk_amp_off>;
	pinctrl-14 = <&ext_spk_amp_ctrl0_on>;
	pinctrl-15 = <&ext_spk_amp_ctrl0_off>;
	pinctrl-16 = <&ext_hp_amp_on>;
	pinctrl-17 = <&ext_hp_amp_off>;
	pinctrl-18 = <&ext_hp_amp_ctrl0_on>;
	pinctrl-19 = <&ext_hp_amp_ctrl0_off>;
	pinctrl-20 = <&ext_hp_amp_ctrl1_on>;
	pinctrl-21 = <&ext_hp_amp_ctrl1_off>;
	status = "okay";
};

&pio {
	aud_clk_mosi_off: aud_clk_mosi_off {
		pins_cmd0_dat {
			pins = <PINMUX_GPIO136__FUNC_GPIO136>;
		};
	};

	aud_clk_mosi_on: aud_clk_mosi_on {
		pins_cmd0_dat {
			pins = <PINMUX_GPIO136__FUNC_AUD_CLK_MOSI>;
		};
	};

	aud_dat_mosi_off: aud_dat_mosi_off {
		pins_cmd1_dat {
			pins = <PINMUX_GPIO138__FUNC_GPIO138>;
		};
		pins_cmd2_dat {
			pins = <PINMUX_GPIO139__FUNC_GPIO139>;
		};
	};

	aud_dat_mosi_on: aud_dat_mosi_on {
		pins_cmd1_dat {
			pins = <PINMUX_GPIO138__FUNC_AUD_DAT_MOSI0>;
		};
		pins_cmd2_dat {
			pins = <PINMUX_GPIO139__FUNC_AUD_DAT_MOSI1>;
		};
	};

	aud_dat_miso_off: aud_dat_miso_off {
		pins_cmd1_dat {
			pins = <PINMUX_GPIO142__FUNC_GPIO142>;
		};
		pins_cmd2_dat {
			pins = <PINMUX_GPIO143__FUNC_GPIO143>;
		};
	};

	aud_dat_miso_on: aud_dat_miso_on {
		pins_cmd1_dat {
			pins = <PINMUX_GPIO142__FUNC_AUD_DAT_MISO0>;
		};
		pins_cmd2_dat {
			pins = <PINMUX_GPIO143__FUNC_AUD_DAT_MISO1>;
		};
	};

	aud_pins_smartpa_off: aud_pins_smartpa_off {
		pins_cmd0_dat {
			pins = <PINMUX_GPIO174__FUNC_GPIO174>;
		};
	};

	aud_pins_smartpa_on: aud_pins_smartpa_on {
		pins_cmd0_dat {
			pins = <PINMUX_GPIO174__FUNC_I2S0_DI>;
		};
	};

	extamp_pullhigh: extamp_pullhigh {
		pins_cmd_dat {
			pins = <PINMUX_GPIO0__FUNC_GPIO0>;
			slew-rate = <1>;
			output-high;
		};
	};

	extamp_pulllow: extamp_pulllow {
		pins_cmd_dat {
			pins = <PINMUX_GPIO0__FUNC_GPIO0>;
			slew-rate = <1>;
			output-low;
		};
	};

	vow_dat_miso_off: vow_dat_miso_off {
		pins_cmd1_dat {
			pins = <PINMUX_GPIO142__FUNC_GPIO142>;
		};
	};

	vow_dat_miso_on: vow_dat_miso_on {
		pins_cmd1_dat {
			pins = <PINMUX_GPIO142__FUNC_VOW_DAT_MISO>;
		};
	};

	vow_clk_miso_off: vow_clk_miso_off {
		pins_cmd3_dat {
			pins = <PINMUX_GPIO143__FUNC_GPIO143>;
		};
	};

	vow_clk_miso_on: vow_clk_miso_on {
		pins_cmd3_dat {
			pins = <PINMUX_GPIO143__FUNC_VOW_CLK_MISO>;
		};
	};

	ext_spk_amp_on: ext_spk_amp_on {
		pins_cmd_dat {
			pins = <PINMUX_GPIO151__FUNC_GPIO151>;
			slew-rate = <1>;
			output-high;
		};
	};

	ext_spk_amp_off: ext_spk_amp_off {
		pins_cmd_dat {
			pins = <PINMUX_GPIO151__FUNC_GPIO151>;
			slew-rate = <1>;
			output-low;
		};
	};

	ext_spk_amp_ctrl0_on: ext_spk_amp_ctrl0_on {
		pins_cmd_dat {
			pins = <PINMUX_GPIO150__FUNC_GPIO150>;
			slew-rate = <1>;
			output-high;
		};
	};

	ext_spk_amp_ctrl0_off: ext_spk_amp_ctrl0_off {
		pins_cmd_dat {
			pins = <PINMUX_GPIO150__FUNC_GPIO150>;
			slew-rate = <1>;
			output-low;
		};
	};

	ext_hp_amp_on: ext_hp_amp_on {
		pins_cmd_dat {
			pins = <PINMUX_GPIO153__FUNC_GPIO153>;
			slew-rate = <1>;
			output-high;
		};
	};

	ext_hp_amp_off: ext_hp_amp_off {
		pins_cmd_dat {
			pins = <PINMUX_GPIO153__FUNC_GPIO153>;
			slew-rate = <1>;
			output-low;
		};
	};

	ext_hp_amp_ctrl0_on: ext_hp_amp_ctrl0_on {
		pins_cmd_dat {
			pins = <PINMUX_GPIO175__FUNC_GPIO175>;
			slew-rate = <1>;
			output-high;
		};
	};

	ext_hp_amp_ctrl0_off: ext_hp_amp_ctrl0_off {
		pins_cmd_dat {
			pins = <PINMUX_GPIO175__FUNC_GPIO175>;
			slew-rate = <1>;
			output-low;
		};
	};

	ext_hp_amp_ctrl1_on: ext_hp_amp_ctrl1_on {
		pins_cmd_dat {
			pins = <PINMUX_GPIO179__FUNC_GPIO179>;
			slew-rate = <1>;
			output-high;
		};
	};

	ext_hp_amp_ctrl1_off: ext_hp_amp_ctrl1_off {
		pins_cmd_dat {
			pins = <PINMUX_GPIO179__FUNC_GPIO179>;
			slew-rate = <1>;
			output-low;
		};
	};
};
/* AUDIO end */

/* CONSYS GPIO standardization */
&pio {
	consys_pins_default: consys_default {
		pins_cmd_dat {
			pins = <PINMUX_GPIO156__FUNC_GPIO156>;
			slew-rate = <1>;
			bias-disable;
			output-high;
		};
	};
	/* "wifi_ant_pins_ol" as alias of main antenna */
	wifi_ant_pins_ol: wifi_ant@1 {
		pins_cmd_dat {
			pins = <PINMUX_GPIO156__FUNC_GPIO156>;
			slew-rate = <1>;
			output-high;
		};
	};
	/* "wifi_ant_pins_oh" as alias of auxiliary antenna */
	wifi_ant_pins_oh: wifi_ant@2 {
		pins_cmd_dat {
			pins = <PINMUX_GPIO156__FUNC_GPIO156>;
			slew-rate = <1>;
			output-low;
		};
	};
};
&consys {
	pinctrl-names = "default", "wifi_ant_state_oh", "wifi_ant_state_ol";
	pinctrl-0 = <&consys_pins_default>;
	pinctrl-1 = <&wifi_ant_pins_oh>;
	pinctrl-2 = <&wifi_ant_pins_ol>;
	tcxo_en = <&pio 7 0>;
	status = "okay";
};
/* CONSYS end */

/* CAMERA GPIO standardization */
&pio {
	camera_pins_cam0_rst_0: cam0@0 {
		pins_cmd_dat {
			pins = <PINMUX_GPIO101__FUNC_GPIO101>;
			slew-rate = <1>; /*direction 0:in, 1:out*/
			output-low;/*direction out used only. output_low or high*/
		};
	};
	camera_pins_cam0_rst_1: cam0@1 {
		pins_cmd_dat {
			pins = <PINMUX_GPIO101__FUNC_GPIO101>;
			slew-rate = <1>;
			output-high;
		};
	};
	camera_pins_cam1_rst_0: cam1@0 {
		pins_cmd_dat {
			pins = <PINMUX_GPIO102__FUNC_GPIO102>;
			slew-rate = <1>; /*direction 0:in, 1:out*/
			output-low;/*direction out used only. output_low or high*/
		};
	};
	camera_pins_cam1_rst_1: cam1@1 {
		pins_cmd_dat {
			pins = <PINMUX_GPIO102__FUNC_GPIO102>;
			slew-rate = <1>;
			output-high;
		};
	};
	camera_pins_cam1_pnd_0: cam1@2 {
		pins_cmd_dat {
			pins = <PINMUX_GPIO98__FUNC_GPIO98>;
			slew-rate = <1>;
			output-low;
		};
	};
	camera_pins_cam1_pnd_1: cam1@3 {
		pins_cmd_dat {
			pins = <PINMUX_GPIO98__FUNC_GPIO98>;
			slew-rate = <1>;
			output-high;
		};
	};
	camera_pins_cam0_mclk_on: camera_pins_cam0_mclk_on {
		pins_cmd_dat {
			pins = <PINMUX_GPIO99__FUNC_CMMCLK0>;
		};
	};
	camera_pins_cam0_mclk_off: camera_pins_cam0_mclk_off {
		pins_cmd_dat {
			pins = <PINMUX_GPIO99__FUNC_GPIO99>;
		};
	};
	camera_pins_cam1_mclk_off: camera_pins_cam1_mclk_off {
		pins_cmd_dat {
			pins = <PINMUX_GPIO100__FUNC_GPIO100>;
		};
	};
	camera_pins_cam1_mclk_on: camera_pins_cam1_mclk_on {
		pins_cmd_dat {
			pins = <PINMUX_GPIO100__FUNC_CMMCLK1>;
		};
	};
	camera_pins_default: camdefault {
		/* power down sensor 0 */
		pins_cmd0_rst_dat {
			pins = <PINMUX_GPIO101__FUNC_GPIO101>;
			slew-rate = <1>; /*direction 0:in, 1:out*/
			output-low;/*direction out used only. output_low or high*/
		};
		/* power down sensor 1 */
		pins_cmd1_rst_dat {
			pins = <PINMUX_GPIO102__FUNC_GPIO102>;
			slew-rate = <1>; /*direction 0:in, 1:out*/
			output-low;/*direction out used only. output_low or high*/
		};
		pins_cmd1_pnd_dat {
			pins = <PINMUX_GPIO98__FUNC_GPIO98>;
			slew-rate = <1>;
			output-high;
		};
	};
};
&kd_camera_hw1 {
	pinctrl-names = "default",
			"cam0_rst0", "cam0_rst1",
			"cam1_rst0", "cam1_rst1",
			"cam1_pnd0", "cam1_pnd1",
			"cam0_mclk_off", "cam0_mclk_on",
			"cam1_mclk_off", "cam1_mclk_on";
	pinctrl-0 = <&camera_pins_default>;
	pinctrl-1 = <&camera_pins_cam0_rst_0>;
	pinctrl-2 = <&camera_pins_cam0_rst_1>;
	pinctrl-3 = <&camera_pins_cam1_rst_0>;
	pinctrl-4 = <&camera_pins_cam1_rst_1>;
	pinctrl-5 = <&camera_pins_cam1_pnd_0>;
	pinctrl-6 = <&camera_pins_cam1_pnd_1>;
	pinctrl-7 = <&camera_pins_cam0_mclk_off>;
	pinctrl-8 = <&camera_pins_cam0_mclk_on>;
	pinctrl-9 = <&camera_pins_cam1_mclk_off>;
	pinctrl-10 = <&camera_pins_cam1_mclk_on>;

	status = "okay";
};

/* UART GPIO */
&apuart0 {
	pinctrl-names = "uart0_gpio_default",
			"uart0_rx_set",
			"uart0_rx_clear",
			"uart0_tx_set",
			"uart0_tx_clear";
	pinctrl-0 = <&uart0_gpio_def_cfg>;
	pinctrl-1 = <&uart0_rx_set_cfg>;
	pinctrl-2 = <&uart0_rx_clr_cfg>;
	pinctrl-3 = <&uart0_tx_set_cfg>;
	pinctrl-4 = <&uart0_tx_clr_cfg>;
	status = "okay";
};

&apuart1 {
	status = "disabled";
};

&apuart2 {
	status = "disabled";
};

&pio {
	/* UART GPIO Settings - Start */
	/* UART0: rx set, rx clear, tx clear, tx clear*/
	uart0_gpio_def_cfg:uart0gpiodefault {

	};
	uart0_rx_set_cfg:uart0_rx_set@gpio95 {
		pins_cmd_dat {
			pins = <PINMUX_GPIO95__FUNC_URXD0>;
		};
	};
	uart0_rx_clr_cfg:uart0_rx_clear@gpio95 {
		pins_cmd_dat {
			pins = <PINMUX_GPIO95__FUNC_GPIO95>;
			slew-rate = <1>;
			output-high;
		};
	};
	uart0_tx_set_cfg:uart0_tx_set@gpio96 {
		pins_cmd_dat {
			pins = <PINMUX_GPIO96__FUNC_UTXD0>;
		};
	};
	uart0_tx_clr_cfg:uart0_tx_clear@gpio96 {
		pins_cmd_dat {
			pins = <PINMUX_GPIO96__FUNC_GPIO96>;
			slew-rate = <1>;
			output-high;
		};
	};
};/* UART GPIO end */

/* IRTX GPIO Start */
&irtx_pwm {
	pinctrl-names = "irtx_gpio_led_default", "irtx_gpio_led_set";
	pinctrl-0 = <&irtx_gpio_led_default>;
	pinctrl-1 = <&irtx_gpio_led_set>;
	status = "okay";
};
&pio {
	/* IRTX GPIO Settings -Start */
	/* default: GPIO0, output, high */
	irtx_gpio_led_default:irtx_gpio_led_def@gpio90 {
		pins_cmd_dat {
			pins = <PINMUX_GPIO90__FUNC_GPIO90>;
			slew-rate = <1>;
			bias-disable;
			output-low;
			input-schmitt-enable = <0>;
		};
	};

	irtx_gpio_led_set:irtx_gpio_led_set@gpio90 {
		pins_cmd_dat {
			pins = <PINMUX_GPIO90__FUNC_PWM_A>;
			slew-rate = <1>;
			output-high;
		};
	};
}; /* IRTX GPIO Settings -End */

&main_pmic {
	interrupt-parent = <&pio>;
	interrupts = <182 IRQ_TYPE_LEVEL_HIGH 190 0>;
	status = "okay";
};

&mt6370_pmu {
	mt6370,intr_gpio_num = <10>; /* direct defined GPIO num */
	mt6370,intr_gpio = <&pio 10 0x0>;
};

&mt6370_typec {
	mt6370pd,intr_gpio_num = <41>; /* direct defined GPIO num */
	mt6370pd,intr_gpio = <&pio 41 0x0>;
};

&mt_pmic_vldo28_ldo_reg {
	regulator-name = "vldo28";
	status = "okay";
};

&mt_pmic_vrf18_ldo_reg {
	regulator-name = "vrf18";
	status = "okay";
};

&mt_pmic_vpa_buck_reg {
	regulator-name = "vpa";
	regulator-min-microvolt = <3300000>;
	regulator-max-microvolt = <3300000>;
	regulator-default-on = <2>; /* 0:skip, 1: off, 2:on */
	status = "okay";
};

&mt_pmic_vsim1_ldo_reg {
	regulator-name = "vsim1";
	regulator-min-microvolt = <3100000>;
	regulator-max-microvolt = <3100000>;
	regulator-enable-ramp-delay = <540>;
	regulator-default-on = <2>; /* 0:skip, 1: off, 2:on */
	status = "okay";
};

/* USB TYPEC GPIO start */
&pio {
	usb_default: usb_default {
	};

	gpio_redriver_c1_init: c1_init {
		pins_cmd_dat {
			pins = <PINMUX_GPIO18__FUNC_GPIO18>;
			slew-rate = <1>;
			output-low;
		};
	};

	gpio_redriver_c1_low: c1_low {
		pins_cmd_dat {
			pins = <PINMUX_GPIO18__FUNC_GPIO18>;
			slew-rate = <1>;
			output-low;
		};
	};

	gpio_redriver_c1_hiz: c1_highz {
		pins_cmd_dat {
			pins = <PINMUX_GPIO18__FUNC_GPIO18>;
			slew-rate= <0>;
			bias-disable;
		};
	};

	gpio_redriver_c1_high: c1_high {
		pins_cmd_dat {
			pins = <PINMUX_GPIO18__FUNC_GPIO18>;
			slew-rate = <1>;
			output-high;
		};
	};

	gpio_redriver_c2_init: c2_init {
		pins_cmd_dat {
			pins = <PINMUX_GPIO17__FUNC_GPIO17>;
			slew-rate = <1>;
			output-low;
		};
	};

	gpio_redriver_c2_low: c2_low {
		pins_cmd_dat {
			pins = <PINMUX_GPIO17__FUNC_GPIO17>;
			slew-rate = <1>;
			output-low;
		};
	};

	gpio_redriver_c2_hiz: c2_highz {
		pins_cmd_dat {
			pins = <PINMUX_GPIO17__FUNC_GPIO17>;
			slew-rate= <0>;
			bias-disable;
		};
	};

	gpio_redriver_c2_high: c2_high {
		pins_cmd_dat {
			pins = <PINMUX_GPIO17__FUNC_GPIO17>;
			slew-rate = <1>;
			output-high;
		};
	};

	gpio_u3_switch_sel1: u3_sw_sel1 {
		pins_cmd_dat {
			pins = <PINMUX_GPIO177__FUNC_GPIO177>;
			slew-rate = <1>;
			output-low;
		};
	};

	gpio_u3_switch_sel2: u3_sw_sel2 {
		pins_cmd_dat {
			pins = <PINMUX_GPIO177__FUNC_GPIO177>;
			slew-rate = <1>;
			output-high;
		};
	};

	gpio_u3_switch_enable: u3_sw_en {
	};

	gpio_u3_switch_disable: u3_sw_dis {
	};
};

&usb_c_pinctrl {
	pinctrl-names = "usb_default",
		"redriver_c1_init",
		"redriver_c1_low",
		"redriver_c1_hiz",
		"redriver_c1_high",
		"redriver_c2_init",
		"redriver_c2_low",
		"redriver_c2_hiz",
		"redriver_c2_high",
		"u3_switch_sel1",
		"u3_switch_sel2",
		"u3_switch_enable",
		"u3_switch_disable";

	pinctrl-0 = <&usb_default>;
	pinctrl-1 = <&gpio_redriver_c1_init>;
	pinctrl-2 = <&gpio_redriver_c1_low>;
	pinctrl-3 = <&gpio_redriver_c1_hiz>;
	pinctrl-4 = <&gpio_redriver_c1_high>;
	pinctrl-5 = <&gpio_redriver_c2_init>;
	pinctrl-6 = <&gpio_redriver_c2_low>;
	pinctrl-7 = <&gpio_redriver_c2_hiz>;
	pinctrl-8 = <&gpio_redriver_c2_high>;
	pinctrl-9 = <&gpio_u3_switch_sel1>;
	pinctrl-10 = <&gpio_u3_switch_sel2>;
	pinctrl-11 = <&gpio_u3_switch_enable>;
	pinctrl-12 = <&gpio_u3_switch_disable>;
	status = "okay";

	usb_switch-data {
		en_pin_num = <0>;
		en_pin_val = <0>; /*DISABLE=0 ENABLE=1*/
		sel_pin_num = <177>;
		sel_pin_val = <1>; /*CC1=1, CC2=2*/
		c1_pin_num = <18>;
		c1_pin_val = <2>; /*Low=0, HighZ=1, High=2*/
		c2_pin_num = <17>;
		c2_pin_val = <1>;
	};
};

/ {
	/delete-node/ otg_iddig;
};
/* USB TYPEC GPIO end */

&mt_pmic_vcamio_ldo_reg {
	regulator-name = "vcamio";
	regulator-default-on = <1>; /* 0:skip, 1: off, 2:on */
	status = "okay";
};
&mt_pmic_vrf12_ldo_reg {
	regulator-name = "vcamd";
	regulator-default-on = <1>; /* 0:skip, 1: off, 2:on */
	status = "okay";
};
&mt_pmic_vcama1_ldo_reg {
	regulator-name = "vcama1";
	regulator-min-microvolt = <2800000>;
	regulator-max-microvolt = <2800000>;
	regulator-default-on = <1>; /* 0:skip, 1: off, 2:on */
	status = "okay";
};

&mt_pmic_vcama2_ldo_reg {
	regulator-name = "vcama2";
	regulator-min-microvolt = <2800000>;
	regulator-max-microvolt = <2800000>;
	regulator-default-on = <1>; /* 0:skip, 1: off, 2:on */
	status = "okay";
};

&pio {
	rfc_id_pin0_default: rfc_id_pin_default {
		pins_cmd_dat {
			pinmux = <PINMUX_GPIO177__FUNC_GPIO177>;
			slew-rate = <0>;
			bias-disable;
		};
	};
	ffc_id_pin1_default: ffc_id_pin_default {
		pins_cmd_dat {
			pinmux = <PINMUX_GPIO176__FUNC_GPIO176>;
			slew-rate = <0>;
			bias-disable;
		};
	};
};

/* charger and gauge */
&lk_charger {
	/delete-property/ enable_pe_plus;
	enable_anime;

	/* charging current */
	ac_charger_input_current = <1900000>;
	non_std_ac_charger_current = <1500000>;
	charging_host_charger_current = <1500000>;
	wpc_charger_input_current = <1100000>;
	wpc_charger_current = <3000000>;

	/* battery temperature protection */
	temp_t4_threshold = <55>;
	temp_t3_threshold = <45>;
	temp_t1_threshold = <15>;

	/* T3/T1 charging current */
	temp_t3_input_current = <1900000>;
	temp_t3_charger_current = <2000000>;
	temp_t1_input_current = <1000000>;
	temp_t1_charger_current = <1000000>;
};

&charger {
	/delete-property/ enable_pe_plus;
	/delete-property/ enable_pe_2;
	/delete-property/ enable_pe_3;
	/delete-property/ enable_pe_4;
	/delete-property/ enable_type_c;

	enable_sw_jeita;
	enable_bat_eoc_protect;
	enable_sw_safety_timer;
	enable_top_off_mode_debounce;

	soc_exit_eoc = <96>;	/* below 96% to exit EOC mode */

	max_charging_time = <72000>;	/* 72000 seconds (20hours) */

	/* common */
	battery_cv = <4400000>;
	battery_cv_aging = <4200000>;
	battery_cv_aging2 = <4000000>;

	ac_charger_input_current = <2500000>;
	ac_charger_current = <3000000>;
	charging_host_charger_current = <1500000>;
	non_std_ac_charger_current = <1500000>;
	wpc_5w_charger_input_current = <1000000>;
	wpc_5w_charger_current = <3000000>;
	wpc_10w_charger_input_current = <1100000>;
	wpc_10w_charger_current = <3000000>;
	wpc_15w_charger_input_current = <1500000>;
	wpc_15w_charger_current = <3000000>;

	/* sw jeita */
	jeita_temp_above_t4_cv_voltage = <4100000>;
	jeita_temp_t3_to_t4_cv_voltage = <4100000>;
	jeita_temp_t2_to_t3_cv_voltage = <4400000>;
	jeita_temp_t1_to_t2_cv_voltage = <4400000>;
	jeita_temp_t0_to_t1_cv_voltage = <4400000>;
	jeita_temp_below_t0_cv_voltage = <4400000>;

	/* SW JEITAfor aging battery */
	jeita_temp_above_t4_cv_voltage_aging = <4100000>;
	jeita_temp_t3_to_t4_cv_voltage_aging = <4100000>;
	jeita_temp_t2_to_t3_cv_voltage_aging = <4200000>;
	jeita_temp_t1_to_t2_cv_voltage_aging = <4200000>;
	jeita_temp_t0_to_t1_cv_voltage_aging = <4200000>;
	jeita_temp_below_t0_cv_voltage_aging = <4200000>;

	jeita_temp_above_t4_cv_voltage_aging2 = <4000000>;
	jeita_temp_t3_to_t4_cv_voltage_aging2 = <4000000>;
	jeita_temp_t2_to_t3_cv_voltage_aging2 = <4000000>;
	jeita_temp_t1_to_t2_cv_voltage_aging2 = <4000000>;
	jeita_temp_t0_to_t1_cv_voltage_aging2 = <4000000>;
	jeita_temp_below_t0_cv_voltage_aging2 = <4000000>;

	temp_t4_threshold = <55>;
	temp_t4_thres_minus_x_degree = <52>;
	temp_t3_threshold = <45>;
	temp_t3_thres_minus_x_degree = <40>;
	temp_t2_threshold = <25>;
	temp_t2_thres_plus_x_degree = <25>;
	temp_t1_threshold = <15>;
	temp_t1_thres_plus_x_degree = <15>;
	temp_t0_threshold = <0>;
	temp_t0_thres_plus_x_degree = <6>;
	temp_neg_10_threshold = <0>;

	temp_t0_charging_current_limit = <600000>;

	/* battery temperature protection */
	enable_min_charge_temperature;
	min_charge_temperature = <0>;
	min_charge_temperature_plus_x_degree = <6>;
	max_charge_temperature = <60>;
	max_charge_temperature_minus_x_degree = <55>;

	top_off_mode_time_threshold = <604800>; /* 7*86400 (7days) */
	top_off_mode_cv = <4200000>; /* CV, uinit:uV */
	top_off_mode_cv_aging = <4200000>; /* CV, uinit:uV */
	top_off_mode_cv_aging2 = <0>; /* CV, uinit:uV */
	top_off_difference_full_cv = <2500>; /* 25% */
	normal_difference_full_cv = <500>; /* 5% */
	vbat_exit_top_off_mode = <4000>; /* 4000mV */

	/* Power detection for HW AICL */
	power_detection_en;
	aicl_trigger_iusb = <3000000>;		/* uA */
	aicl_trigger_ichg = <2900000>;		/* uA */
	adapter_9w_aicl_min = <1800000>;	/* uA */
	adapter_12w_aicl_min = <2400000>;	/* uA */
	adapter_5w_iusb_lim = <1000000>;	/* uA */
	adapter_9w_iusb_lim = <1800000>;	/* uA */
	adapter_12w_iusb_lim = <2500000>;	/* uA */
	mivr_detect = <4400000>;	/* uV */
	dcap_support;
};
&pio {
	pwr_switch_default: pwr_switch_default {
		nEN_pin {
			pins = <PINMUX_GPIO76__FUNC_GPIO76>;
			slew-rate = <1>;
			output-low;
			bias-disable;
		};
		otg_en {
			pins = <PINMUX_GPIO75__FUNC_GPIO75>;
			slew-rate = <1>;
			output-low;
			bias-disable;
		};
	};
	sgm2541_auto: sgm2541_auto {
		nEN_pin {
			pins = <PINMUX_GPIO76__FUNC_GPIO76>;
			slew-rate = <1>;
			output-low;
			bias-disable;
		};
	};
	sgm2541_slave: sgm2541_slave {
		nEN_pin {
			pins = <PINMUX_GPIO76__FUNC_GPIO76>;
			slew-rate = <1>;
			output-high;
			bias-disable;
		};
	};
	otg_enable: otg_enable {
		otg_en {
			pins = <PINMUX_GPIO75__FUNC_GPIO75>;
			slew-rate = <1>;
			output-high;
			bias-disable;
		};
	};
	otg_disable: otg_disable {
		otg_en {
			pins = <PINMUX_GPIO75__FUNC_GPIO75>;
			slew-rate = <1>;
			output-low;
			bias-disable;
		};
	};
};
&mt6370_pmu {
	charger {
		enable_load_switch = <0>;
		pinctrl-names = "pwr_switch_default",
			"sgm2541_auto", "sgm2541_slave",
			"otg_enable", "otg_disable";
		pinctrl-0 = <&pwr_switch_default>;
		pinctrl-1 = <&sgm2541_auto>;
		pinctrl-2 = <&sgm2541_slave>;
		pinctrl-3 = <&otg_enable>;
		pinctrl-4 = <&otg_disable>;

		ichg = <3000000>;		/* uA */
		safety_timer = <20>;		/* hour */
		ircmp_resistor = <25000>;	/* uohm */
		ircmp_vclamp = <64000>;		/* uV */
		ieoc = <350000>;		/* uA */
		mivr = <4500000>;		/* uV */
		aicl_vth_offset = <200000>;	/* uV */
		aicl_err_h = <200000>;		/* uA */
		aicl_err_l = <100000>;		/* uA */
		en_tcpc;
	};
};
&bat_gm30 {
	ui_fast_tracking_en = <0>;

	R_FG_VALUE = <(10)>;	/* R_sense resistance. */
	CAR_TUNE_VALUE = <(100)>;	/* Tune value for current measurement.*/
	DIFFERENCE_FULLOCV_ITH = <(450)>;	/* Charging termination current. */
	DIFFERENCE_FULLOCV_VTH = <(200)>;	/* 200mV */
	MIN_BATTERY_TEMP = <(-10)>;
	use_adc_id;
	adc_channel = <4>;
	bat_id_volt_thres = <1100 (-1)>;
	cell_id_name = "ATL", "CosMX";

	/* IDME battery ID */
	battery0_profile_id = <0x1441>;
	battery0_profile_name = "NVT/ATL";
	battery1_profile_id = <0x1451>;
	battery1_profile_name = "SCUD/ATL";
	battery2_profile_id = <0x1456>;
	battery2_profile_name = "SCUD/CosMX";

	battery0_profile_1_id = <0x1441>;
	battery0_profile_1_name = "NVT/ATL";
	battery1_profile_1_id = <0x1451>;
	battery1_profile_1_name = "SCUD/ATL";
	battery2_profile_1_id = <0x1456>;
	battery2_profile_1_name = "SCUD/CosMX";

	battery0_profile_2_id = <0x1441>;
	battery0_profile_2_name = "NVT/ATL";
	battery1_profile_2_id = <0x1451>;
	battery1_profile_2_name = "SCUD/ATL";
	battery2_profile_2_id = <0x1456>;
	battery2_profile_2_name = "SCUD/CosMX";

	Q_MAX_T0 = <6500 6500>;
	Q_MAX_T1 = <6500 6500>;
	Q_MAX_T2 = <6500 6500>;
	Q_MAX_T3 = <6500 6500>;
	Q_MAX_T4 = <6500 6500>;

	Q_MAX_H_CURRENT_T0 = <6500 6500>;
	Q_MAX_H_CURRENT_T1 = <6500 6500>;
	Q_MAX_H_CURRENT_T2 = <6500 6500>;
	Q_MAX_H_CURRENT_T3 = <6500 6500>;
	Q_MAX_H_CURRENT_T4 = <6500 6500>;

	Q_MAX_1_T0 = <5500 5500>;
	Q_MAX_1_T1 = <5500 5500>;
	Q_MAX_1_T2 = <5500 5500>;
	Q_MAX_1_T3 = <5500 5500>;
	Q_MAX_1_T4 = <5500 5500>;

	Q_MAX_H_CURRENT_1_T0 = <5500 5500>;
	Q_MAX_H_CURRENT_1_T1 = <5500 5500>;
	Q_MAX_H_CURRENT_1_T2 = <5500 5500>;
	Q_MAX_H_CURRENT_1_T3 = <5500 5500>;
	Q_MAX_H_CURRENT_1_T4 = <5500 5500>;

	Q_MAX_2_T0 = <4050 3900>;
	Q_MAX_2_T1 = <4150 3800>;
	Q_MAX_2_T2 = <3800 3450>;
	Q_MAX_2_T3 = <3500 3250>;
	Q_MAX_2_T4 = <3500 2850>;

	Q_MAX_H_CURRENT_2_T0 = <4050 3900>;
	Q_MAX_H_CURRENT_2_T1 = <4150 3800>;
	Q_MAX_H_CURRENT_2_T2 = <3800 3450>;
	Q_MAX_H_CURRENT_2_T3 = <3500 3250>;
	Q_MAX_H_CURRENT_2_T4 = <3500 2850>;

	#include "bat_setting/mt8183_battery_table_ext_EVT_0x1451_SCUD_ATL.dtsi"
	#include "bat_setting/mt8183_battery_table_ext_DVT_0x1451_SCUD_ATL_4p2V.dtsi"
	#include "bat_setting/mt8183_battery_table_ext_DVT_0x1451_SCUD_ATL_4V.dtsi"
	#include "bat_setting/mt8183_battery_table_ext_EVT_0x1456_SCUD_CosMX.dtsi"
	#include "bat_setting/mt8183_battery_table_ext_DVT_0x1456_SCUD_CosMX_4p2V.dtsi"
	#include "bat_setting/mt8183_battery_table_ext_DVT_0x1456_SCUD_CosMX_4V.dtsi"
};

/* wireless charger */
&pio {
	p9415_pins_default: p9415_pins_default {
		irq_pin {
			pins = <PINMUX_GPIO19__FUNC_GPIO19>;
			slew-rate = <0>;
			bias-pull-up;
		};
		nEN_pin {
			pins = <PINMUX_GPIO80__FUNC_GPIO80>;
			slew-rate = <1>;
			output-low;
			bias-disable;
		};
		epp_disable_pin {
			pins = <PINMUX_GPIO18__FUNC_GPIO18>;
			slew-rate = <1>;
			output-low;
			bias-disable;
		};
		pg_pin {
			pins = <PINMUX_GPIO74__FUNC_GPIO74>;
			slew-rate = <0>;
			bias-pull-down;
		};
		fw_dl_ctrl {
			pins = <PINMUX_GPIO9__FUNC_GPIO9>;
			slew-rate = <1>;
			output-low;
			bias-disable;
		};
		sleep_pin {
			pins = <PINMUX_GPIO160__FUNC_GPIO160>;
			slew-rate = <1>;
			output-low;
			bias-disable;
		};
	};

    wpc_enable: wpc_enable {
		nEN_pin {
			pins = <PINMUX_GPIO80__FUNC_GPIO80>;
			slew-rate = <1>;
			output-low;
			bias-disable;
		};
	};
    wpc_disable: wpc_disable {
		nEN_pin {
			pins = <PINMUX_GPIO80__FUNC_GPIO80>;
			slew-rate = <1>;
			output-high;
			bias-disable;
		};
	};

	epp_enable: epp_enable {
		epp_disable_pin {
			pins = <PINMUX_GPIO18__FUNC_GPIO18>;
			slew-rate = <1>;
			output-low;
			bias-disable;
		};
	};

	epp_disable: epp_disable {
		epp_disable_pin {
			pins = <PINMUX_GPIO18__FUNC_GPIO18>;
			slew-rate = <1>;
			output-high;
			bias-disable;
		};
	};

	fw_dl_enable: fw_dl_enable {
		fw_dl_ctrl {
			pins = <PINMUX_GPIO9__FUNC_GPIO9>;
			slew-rate = <1>;
			output-high;
			bias-disable;
		};
	};

	fw_dl_disable: fw_dl_disable {
		fw_dl_ctrl {
			pins = <PINMUX_GPIO9__FUNC_GPIO9>;
			slew-rate = <1>;
			output-low;
			bias-disable;
		};
	};

	sleep_enable: sleep_enable {
		sleep_pin {
			pins = <PINMUX_GPIO160__FUNC_GPIO160>;
			slew-rate = <1>;
			output-high;
			bias-disable;
		};
	};
	sleep_disable: sleep_disable {
		sleep_pin {
			pins = <PINMUX_GPIO160__FUNC_GPIO160>;
			slew-rate = <1>;
			output-low;
			bias-disable;
		};
	};

};

&i2c3 {
	p9415@3b {
		compatible = "IDT,p9415";
		reg = <0x3b>;

		interrupt-parent = <&pio>;
		interrupts = <19 IRQ_TYPE_EDGE_FALLING 19 0>,
			<74 IRQ_TYPE_EDGE_RISING 74 0>;

		pinctrl-names = "default", "wpc_enable", "wpc_disable",
			"epp_enable", "epp_disable",
			"fw_dl_enable", "fw_dl_disable",
			"sleep_enable", "sleep_disable";
		pinctrl-0 = <&p9415_pins_default>;
		pinctrl-1 = <&wpc_enable>;
		pinctrl-2 = <&wpc_disable>;
		pinctrl-3 = <&epp_enable>;
		pinctrl-4 = <&epp_disable>;
		pinctrl-5 = <&fw_dl_enable>;
		pinctrl-6 = <&fw_dl_disable>;
		pinctrl-7 = <&sleep_enable>;
		pinctrl-8 = <&sleep_disable>;
		p9415-irq = <&pio 19 0>;
		p9415-pg-gpio = <&pio 74 0>;

		vout_10w = /bits/ 16 <9000>;
		vout_15w = /bits/ 16 <10000>;

		wpc-mivr = <4500000 4500000 4500000>;

		bpp-5w-fod = /bits/ 8 <0x8C 0x3A 0x7F 0x00
			0x7C 0x39 0x93 0x16
			0x99 0x5 0xA7 0xD6>;
		epp-10w-fod = /bits/ 8 <0x8E 0x44 0x7F 0x0
			0x7F 0x0 0x8D 0x2B
			0x93 0xA 0x97 0xEE>;
		bpp-plus-15w-fod = /bits/ 8 <0x76 0x54 0x8c 0x46
			0x8c 0x46 0x93 0xee
			0x97 0xd8 0x91 0x0>;

		throttle_threshold = <44>;
		throttle_hysteresis_threshold = <42>;

		status = "disabled";
	};
};
/* wireless charger end */
/* charger and gauge end */

/* SENSOR start */
&i2c1 {
	dualals1:stk3x1x@48 {
		compatible = "mediatek,alsps";
		i2c_num = <1>;
		reg = <0x48>;
		i2c_addr = <0x48 0x00 0x00 0x00>;
		polling_mode_ps = <1>;
		polling_mode_als = <1>;
		power_id = <0xffff>;
		power_vol = <0>;
		ps_threshold_high = <120>;
		ps_threshold_low = <100>;
		is_batch_supported_ps = <0>;
		is_batch_supported_als = <0>;
		cali_compen_20 = <1050>;
		cali_compen_400 = <1098>;
		sensor_num = <1>;
		is_master = <1>;
	};

	dualals3:ltrx130a@53 {
		compatible = "mediatek,ltrx130a";
		i2c_num = <1>;
		reg = <0x53>;
		i2c_addr = <0x53 0x00 0x00 0x00>;
		polling_mode_ps = <1>;
		polling_mode_als = <1>;
		power_id = <0xffff>;
		power_vol = <0>;
		ps_threshold_high = <120>;
		ps_threshold_low = <100>;
		is_batch_supported_ps = <0>;
		is_batch_supported_als = <0>;
		sensor_num = <1>;
		is_master = <1>;
	};

	bma2xx:bma2xx@19{
		compatible = "mediatek,gsensor";
		i2c_num = <1>;
		reg = <0x19>;
		i2c_addr = <0x19 0 0 0>;
		direction = <5>;
		power_id = <0xffff>;
		power_vol = <0>;
		firlen = <0>;
		is_batch_supported = <0>;
	};

	stk8baxx:stk8baxx@18{
		compatible = "mediatek,stk8baxx";
		i2c_num = <1>;
		reg = <0x18>;
		i2c_addr = <0x18 0 0 0>;
		direction = <5>;
		power_id = <0xffff>;
		power_vol = <0>;
		firlen = <0>;
		is_batch_supported = <0>;
		range = <4>;
	};
};
/* SENSOR end */

/* SD GPIO */
&msdc1 {
	pinctrl-names = "default";
	pinctrl-0 = <&msdc1_pins_sddefault>;
	status = "okay";
};

&pio {
	/* SD GPIO Settings - default */
	msdc1_pins_sddefault: msdc1@sddefault {
		pins_cmd_dat {
			pins = <PINMUX_GPIO3__FUNC_GPIO3>;
			slew-rate = <0>;
			bias-pull-up;
		};
	};
};
/* SD GPIO end */

&i2c3 {
	clock-frequency = <400000>;
	status = "okay";
	fusb251@28 {
		compatible = "on,fusb251";
		reg = <0x28>;
		/* i2c_num = <2>; */
		/* i2c_addr = <0x28 0 0 0>; */
		threshold1_sbu_det_dry2wet = <747>;
		threshold1_sbu_det_wet2dry = <960>;
		threshold2_sbu_float_det = <100>;
		status = "okay";
	};
};

/* typec */
&i2c5 {
	usb_type_c_mtk:usb_type_c@4e {
		status = "okay";
		compatible = "mediatek,usb_type_c";
		reg = <0x4e>;
	};
};

&i2c6 {
	rt551x: audio-codec@57 {
		compatible = "realtek,rt551x";
		#sound-dai-cells = <0>;
		reg = <0x57>;
		interrupt-parent = <&pio>;
		interrupts = <169 IRQ_TYPE_LEVEL_HIGH 169 0>;
		rt5518-reset = <&pio 178 0>;
		hw_analog_gain = <0xe>;
		hw_digital_gain = <0x891c>;
		pinctrl-names = "default", "rt551x_hwreset_enable",
				"rt551x_hwreset_disable";
		pinctrl-0 = <&rt551x_default>;
		pinctrl-1 = <&rt551x_hwreset_enable>;
		pinctrl-2 = <&rt551x_hwreset_disable>;
	};
};

&pio {
	rt551x_default: rt551x_default {
		pins_cmd_dat {
			pins = <PINMUX_GPIO178__FUNC_GPIO178>;
			slew-rate = <1>;
			output-high;
		};
	};
	rt551x_hwreset_enable: rt551x_hwreset_enable {
		pins_cmd_dat {
			pins = <PINMUX_GPIO178__FUNC_GPIO178>;
			slew-rate = <1>;
			output-low;
		};
	};
	rt551x_hwreset_disable: rt551x_hwreset_disable {
		pins_cmd_dat {
			pins = <PINMUX_GPIO178__FUNC_GPIO178>;
			slew-rate = <1>;
			output-high;
		};
	};
};

&spi1 {
	pinctrl-names = "default";
	pinctrl-0 = <&spi_pins_1>;
	mediatek,pad-select = <0>;
	status = "okay";
	/* clients */
	rt551x_spi: audio-codec@0 {
		compatible = "realtek,rt551x";
		reg = <0x0>;
		spi-max-frequency = <18000000>;
	};
};

&audio {
	channel-type = <0>; /* 0(Stereo) 1(MonoLeft) 2(MonoRight) */
	sound-dai = <&rt551x>;
};

&disp_aal0 {
	aal_support = <0>;
};

/* KPD */
/* overwite cust.dtsi settings generated from trona.dws */
&keypad {
	mediatek,kpd-key-debounce = <1024>;
	mediatek,kpd-sw-pwrkey = <116>;
	mediatek,kpd-hw-pwrkey = <8>;
	mediatek,kpd-sw-rstkey  = <0>;
	mediatek,kpd-hw-rstkey = <17>;
	mediatek,kpd-use-extend-type = <0>;
	/*HW Keycode [0~71] -> Linux Keycode*/
	mediatek,kpd-hw-map-num = <72>;
	mediatek,kpd-hw-init-map = <114 115 0 0 0 0 0 0 0 0 0 0 0 0 0 0 0 0 0 0 0 0 0 0
			0 0 0 0 0 0 0 0 0 0 0 0 0 0 0 0 0 0 0 0 0 0 0 0
			0 0 0 0 0 0 0 0 0 0 0 0 0 0 0 0 0 0 0 0 0 0 0 0 >;
	mediatek,kpd-pwrkey-eint-gpio = <0>;
	mediatek,kpd-pwkey-gpio-din  = <0>;
	mediatek,kpd-hw-recovery-key = <1>;
	mediatek,kpd-hw-fastboot-key = <0>;
	/delete-property/mediatek,kpd-hw-dl-key2;
	status = "okay";
};
/* KPD end */
&led6 {
	brightness-normalize-enable = <1>;
	chosen-id = <>;
	brightness-normalize-count = <10>;
	brightness-normalize-table = <
				/* <panel-id base scale def> */
				0 450 450 77 /*Starry(BOE)*/
				1 472 472 77 /*KD(Mantix)*/
				2 434 434 77 /*KD(HSD) removed*/
				3 429 429 77 /*TG(BOE)*/
				4 445 445 77 /*ST(HSD)*/
				5 416 416 77 /*TG(BOE) removed*/
				6 460 460 77 /*TG(BOE)*/
				7 450 450 77 /*KD(INX)*/
				16 435 435 77 /*ST(BOE)*/
				23 435 435 77 /*KD(INX)*/ >;
};

&pmic_clock_buffer_ctrl {
	xowcn-gpios=<&pio 7 0>;
};

/* Amazon LD */
&pio {
	/* LD1(MISC_BSI_DO_0) -> GPIO63 */
	ld_pin1_init: ld1_init {
		pins_cmd_dat {
			pins = <PINMUX_GPIO63__FUNC_GPIO63>;
			slew-rate = <1>;
			output-low;
		};
	};

	ld_pin1_low: ld1_low {
		pins_cmd_dat {
			pins = <PINMUX_GPIO63__FUNC_GPIO63>;
			slew-rate = <1>;
			output-low;
		};
	};

	ld_pin1_high: ld1_high {
		pins_cmd_dat {
			pins = <PINMUX_GPIO63__FUNC_GPIO63>;
			slew-rate = <1>;
			output-high;
		};
	};

	/* LD2(MISC_BSI_CK_0) -> GPIO64 */
	ld_pin2_init: ld2_init {
		pins_cmd_dat {
			pins = <PINMUX_GPIO64__FUNC_GPIO64>;
			slew-rate = <1>;
			output-low;
		};
	};

	ld_pin2_low: ld2_low {
		pins_cmd_dat {
			pins = <PINMUX_GPIO64__FUNC_GPIO64>;
			slew-rate = <1>;
			output-low;
		};
	};

	ld_pin2_high: ld2_high {
		pins_cmd_dat {
			pins = <PINMUX_GPIO64__FUNC_GPIO64>;
			slew-rate = <1>;
			output-high;
		};
	};

	/* OPA_SBU1|OPA_SBU2 SWITCH GPIO Settings */
	adcsw2_switch_init: adcsw2_init {
		pins_cmd_dat {
			pins = <PINMUX_GPIO55__FUNC_GPIO55>;
			slew-rate = <1>;
			output-low;
			bias-disable;
		};
	};

	adcsw2_switch_opa_sbu1: switch_opa_sbu1 {
		pins_cmd_dat {
			pins = <PINMUX_GPIO55__FUNC_GPIO55>;
			slew-rate = <1>;
			output-low;
			bias-disable;
		};
	};

	adcsw2_switch_opa_sbu2: switch_opa_sbu2 {
		pins_cmd_dat {
			pins = <PINMUX_GPIO55__FUNC_GPIO55>;
			slew-rate = <1>;
			output-high;
			bias-disable;
		};
	};
};

&odm {
	ld {
		compatible = "amzn,ld";
		status = "okay";
		adc_channel = <4 4>;
		threshold = <120 1450>;
		ctrl_mode = <2>; /* 0: Not Control, 1: Disable USB, 2: Sink-Only */
		pinctrl-names = "ld1_init", "ld1_low", "ld1_high",
				"ld2_init", "ld2_low", "ld2_high",
				"adcsw2_init", "switch_opa_sbu1", "switch_opa_sbu2";

		pinctrl-0 = <&ld_pin1_init>;
		pinctrl-1 = <&ld_pin1_low>;
		pinctrl-2 = <&ld_pin1_high>;
		pinctrl-3 = <&ld_pin2_init>;
		pinctrl-4 = <&ld_pin2_low>;
		pinctrl-5 = <&ld_pin2_high>;
		pinctrl-6 = <&adcsw2_switch_init>;
		pinctrl-7 = <&adcsw2_switch_opa_sbu1>;
		pinctrl-8 = <&adcsw2_switch_opa_sbu2>;
	};
};
/* Amazon LD end*/
/*End of this file, DO NOT ADD ANYTHING HERE*/
