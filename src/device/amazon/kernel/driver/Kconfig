## src/device/amazon/kernel/driver/Kconfig
```kconfig
menu "Amzn"

config AMZN
	bool "Amazon Common Drivers"
	default N
	---help---
	  Enable support for various drivers needed on the Amazon Fire OS platform

if AMZN

config AMZN_SIGN_OF_LIFE
	bool "Amazon Sign of Life"
	help
	enable the life cycle metrics to log device boot and shutdown information

config AMZN_SIGN_OF_LIFE_RTC
        bool "Amazon Sign of Life platform implementation"
        help
        enable the life cycle metrics to log device boot and shutdown information on specific Platform

config AMZN_POWEROFF_LOG
	bool "Long press key power off log"
	default N
	help
	enable Long press key power off log

config AMZN_METRICS_LOG
	bool "Amazon Metrics logger driver"
	select RING_BUFFER
	default n
	---help---
		Enable Amazon Metrics/Vitals logger driver

config AMZN_METRICS_LOG_TEST
	tristate "Amazon Metrics logger driver test module"
	depends on AMZN_METRICS_LOG
	default n
	---help---
		Enable Amazon Metrics/Vitals logger test module

config AMZN_INPUT_KEYCOMBO
	tristate "Amazon key combo"
	depends on INPUT
	select INPUT_KEYCOMBO
	help
	  Say Y here if you want to panic kernel / power off when some keys are pressed;

	  To compile this driver as a module, choose M here: the
	  module will be called amzn_keycombo.

config AMZN_IDME
	bool "IDME support"
	depends on PROC_FS
	help
	  Select Y here to enable IDME support to read the data
	  via userspace (i.e. /proc/idme/* entries)

config AMZN_DRV_TEST
	tristate "Amazon common BSP driver test module"
	depends on AMZN_METRICS_LOG && AMZN_SIGN_OF_LIFE && AMZN_IDME
	default n
	---help---
		Enable Amazon Common BSP test module

endif # if AMZN

endmenu
```

## src/kernel/mediatek/4.4/drivers/misc/bma4xy/Kconfig
```kconfig
#
# Makefile for Bosch sensors driver.
#
config BOSCH_DRIVER_LOG_FUNC
	tristate "Bosch Sensortec driver smart log function support"
	depends on (I2C || SPI_MASTER) && SYSFS
	help
	 If you say yes here, you get support for smart log function in Bosch Sensortec driver.

config SENSORS_BMA456
	tristate "BMA456 Sensor Support"
	default y
	depends on I2C && SYSFS
	help
	If you say yes here, you get support for Bosch Sensortec's sensor driver of BMA456.

config BMA4XY_LOAD_CONFIG_FILE_IN_INIT
	bool "BMA4XY Sensor configuration loading at boot time support"
	default y
	depends on SENSORS_BMA456
	help
	 If you say yes here, the bma456 configuration is loaded at boot time
	 else user has to load the configuration through SYSFS before using the sensor.
```

## src/kernel/mediatek/4.4/drivers/misc/mediatek/sensors-1.0/accelerometer/stk8baxx/Kconfig
```kconfig
config MTK_STK8BAXX
	bool "STK8BAXX for MediaTek package"
	default y
	help
        If this option is set, It will support Stk8baxx Accelerometer.
```

## src/kernel/mediatek/4.4/drivers/misc/mediatek/thermal/common/thermal_zones/Kconfig
```kconfig
menuconfig MTK_THERMAL
	bool "MediaTek Thermal Zone"
	help
	    Config MTK thernal zone drivers.

if MTK_THERMAL
config MTK_THERMAL_ZONE_BATTERY
	bool "MTK Thermal Zone Battery"
	depends on THERMAL
	help
	    Enable battery thermal zone.

config VIRTUAL_SENSOR_THERMAL_MTK_BATTERY
	bool "MTK Virtual Thermal Sensor Battery"
	depends on VIRTUAL_SENSOR_THERMAL
	help
	    Enable battery virtual thermal sensor.

endif
```

## src/kernel/mediatek/4.4/drivers/misc/motion_controller/Kconfig
```kconfig
comment "motion controller module"

config MOTION_CONTROL
	tristate "Motion control support"
	depends on SPI
	help
	  An Motion Control module for abc123. Say Y when you want to support this tool.
```

## src/kernel/mediatek/4.4/drivers/misc/tcs3400/Kconfig
```kconfig
config SENSORS_TCS3400
	tristate "AMS-TAOS TCS3400 Color and IR sensor"
	depends on I2C
	default n
	help
	  If you say yes here you get support for the ams-taos tcs3400,
	  ALS/Color sensor.
	  This driver can also be built as a module.  If so, the module
	  will be called tcs3400.
```

## src/kernel/mediatek/4.4/drivers/misc/tcs3430/Kconfig
```kconfig
config SENSORS_TCS3430
	tristate "AMS-TAOS TCS3430 ALS/COLOR Sensor"
	depends on I2C
	default n
	help
	  If you say yes here you get support for the ams-taos tcs3430 als/color sensor.
	  This driver can also be built as a module.  If so, the module
	  will be called tcs3430.ko.
```

## src/kernel/mediatek/4.4/drivers/staging/amazon/Kconfig
```kconfig
menu "Amazon"

config AMAZON
	bool "Amazon Drivers"
	default N
	---help---
	  Enable support for various drivers needed on the Amazon Fire OS platform

if AMAZON


config AMAZON_SIGN_OF_LIFE
	bool "Amazon Sign of Life"
	help
	enable the life cycle metrics to log device boot and shutdown information

config AMAZON_SIGN_OF_LIFE_MTK
	bool "Amazon Sign of Life MTK platform implementation"
	help
	enable the life cycle metrics to log device boot and shutdown information on MTK Platform

config AMAZON_METRICS_LOG
	bool "Amazon Metrics logger driver"
	select RING_BUFFER
	default n
	---help---
		Enable Amazon Metrics/Vitals logger driver

config AMAZON_POWEROFF_LOG
	bool "Long press key power off log"
	default N
	help
	enable Long press key power off log

config AMAZON_METRICS_LOG_TEST
	tristate "Amazon Metrics logger driver test module"
	depends on AMAZON_METRICS_LOG
	default n
	---help---
		Enable Amazon Metrics/Vitals logger test module

config INPUT_AMZN_KEYCOMBO
	tristate "Amazon key combo"
	depends on INPUT
	select INPUT_KEYCOMBO
	---help---
	  Say Y here if you want to panic kernel / power off when some keys are pressed;

	  To compile this driver as a module, choose M here: the
	  module will be called amzn_keycombo.

config AMAZON_INTEGRITY_MODULE
	tristate "Amazon Integrity Module"
	depends on AMAZON_METRICS_LOG
	---help---
	  Say Y here if you want to enable Amazon Integrity Module

config AMAZON_LD
	tristate "Amazon LD Module"
	depends on TCPC_CLASS
	---help---
	  Say Y here if you want to enable Amazon Liquid Detection Module

config USER_BUILD
	bool "Indicate if user build"
	default n
	---help---
	  Indicate if user build

endif # if AMAZON

endmenu
```

## src/kernel/mediatek/mt8183/4.4/drivers/input/touchscreen/mediatek/FT8201AB/Kconfig
```kconfig
#
# Focaltech Touchscreen driver configuration
#

config TOUCHSCREEN_FTS_8201AB
    bool "Focaltech Touchscreen"
    default n
    help
      Say Y here if you have Focaltech touch panel.
      If unsure, say N.

config TOUCHSCREEN_FTS_DIRECTORY
    string "Focaltech ts directory name"
    default "FT8201AB"
    depends on TOUCHSCREEN_FTS_8201AB
```

## src/kernel/mediatek/mt8183/4.4/drivers/input/touchscreen/mediatek/NT36523/Kconfig
```kconfig
#
# Novatek NT36523 touchscreen driver configuration
#
config TOUCHSCREEN_NT36523
	bool "Novatek NT36523"
	default n
	help
	  Say Y here if you have a Novatek NT36xxx touchscreen connected
	  to your system.
	  If unsure, say N.
```

## src/kernel/mediatek/mt8183/4.4/drivers/misc/fusb/Kconfig
```kconfig
config FUSB251
   tristate "fusb251 driver"
   depends on I2C
   default n
   help
     Say Y here to enable support for type-c CC and SBU protection
     IC FUSB251.
```

## src/kernel/mediatek/mt8183/4.4/drivers/misc/mediatek/base/power/clkbuf_v1/mt8183/Kconfig
```kconfig
config CLKBUF_MT8183_XOWCN_COCLOCK
	bool "CLKBUF MT8183 XOWCN COCLOCK"
	help
	  It's a co-clock solution for connectivity on MT8183.
	  Set y, if need co-clock support and will detect via gpio.
```

## src/kernel/mediatek/mt8183/4.4/drivers/misc/mediatek/imgsensor/Kconfig
```kconfig
config MTK_IMGSENSOR
  bool CONFIG_MTK_IMGSENSOR
  default n
  help
    CONFIG_MTK_IMGSENSOR

config CAM_AVDD_SRC_SWITCH
	bool "LDO/ PMIC switching for RFC AVDD source switching"
	default n
	help
	  CONFIG_CAM_AVDD_SRC_SWITCH define if RFC AVDD source need to switch should be built in or
	  not.

source "drivers/misc/mediatek/imgsensor/src/Kconfig"
```

## src/kernel/mediatek/mt8183/4.4/drivers/misc/mediatek/sensors-1.0/accelerometer/da228/Kconfig
```kconfig
config MTK_DA228
	bool "DA228 for MediaTek package"
	default n
	help
		If this option is set, It will support miramems da228 Accelerometer.
```

## src/kernel/mediatek/mt8183/4.4/drivers/misc/mediatek/sensors-1.0/alsps/ltrx130a_dual/Kconfig
```kconfig
config MTK_LTRX130A_DUAL
	bool "ltrx130a alsps sensor for MediaTek package"
	default n
```

## src/kernel/mediatek/mt8183/4.4/drivers/misc/mediatek/sensors-1.0/magnetometer/cmc306a/Kconfig
```kconfig
config MTK_CMC306A_NEW
	bool "CMC306A for MediaTek package"
	default n
	help
	  It support different magnetometer sensor.
          If this option is set,
	  it will support
          CMC306A magnetometer.
```

## src/kernel/mediatek/mt8183/4.4/drivers/misc/mediatek/thermal/Kconfig
```kconfig
config MTK_THERMAL_PA_VIA_ATCMD
	bool "Thermal switch for query modem RF temp"
	help
	  Internal switch for thermal management
	  to query modem RF temperature
	  via AT command.
	  (RIL sockets)

config CLATM_CHOOSE_HIGHER_TARGET_TJ
	bool "adaptive cooler will choose the one who has higher target Tj"
	help
	  Change ATM decide TTj logic.
	  It will choose the adaptive cooler with higher Target Tj
	  and use the higher trip point as target Tj
	  when more than one adaptive active.
	default n

config VS_BACKLIGHT_COOLER
	bool "Virtual Sensor backlight cooler"
	default n

config VS_BCCT_COOLER
	bool "Virtual Sensor battery current cooler"
	default n

source "drivers/misc/mediatek/thermal/common/thermal_zones/Kconfig"
```

## src/kernel/mediatek/mt8183/4.4/drivers/misc/mediatek/thermal/common/thermal_zones/Kconfig
```kconfig
#
# thermal driver configuration
#

config THERMAL_BTS_AMP
	bool "WPC area thermal monitor"
	depends on THERMAL
	help
		Enable driver to monitor thermistor around Smart AMP & SPK AMP area.
```

## src/kernel/mediatek/mt8183/4.4/drivers/staging/amazon/dspframework/Kconfig
```kconfig
menu "Amazon dsp framework driver"

config AMAZON_DSP_FRAMEWORK
	tristate "adf support"
	default n
	help
		support adf;

endmenu
```

## src/kernel/mediatek/mt8183/4.4/drivers/thermal/virtual_sensor_tablet/Kconfig
```kconfig
config THERMAL_FOD
   bool "Mechanism to detect foreign ojbect"
   help
     Whenever wireless charging is working, avoid the inablility to correctly
     detect foregin objects and cause the deivce to overheat.

config AMZN_THERMAL_VIRTUAL_SENSOR
   bool "VIRTUAL_SENSOR thermal management"
   help
     Adds VIRTUAL_SENSOR thermal management implementation according to the thermal
     management framework. A thermal zone with several trip points will be
     created. Cooling devices can be bound to the trip points to cool this
     thermal zone if trip points reached.

config THERMAL_SHUTDOWN_LAST_KMESG
   bool "THERMAL_SHUTDOWN_LAST_KMESG save the last kmsg"
   help
     Save the last kmsg when thermal shuts down the system.
```
