/*
 * Copyright (C) 2018 MediaTek Inc.
 *
 * This program is free software; you can redistribute it and/or modify
 * it under the terms of the GNU General Public License version 2 as
 * published by the Free Software Foundation.
 *
 * This program is distributed in the hope that it will be useful,
 * but WITHOUT ANY WARRANTY; without even the implied warranty of
 * MERCHANTABILITY or FITNESS FOR A PARTICULAR PURPOSE.  See the
 * GNU General Public License for more details.
 */

#include "mt8183.dts"
#include <maverick/cust.dtsi>

/ {
	version = "hvt1p0";
};

&reserved_memory {
	#address-cells = <2>;
	#size-cells = <2>;
	ranges;

	zmc-default {
		compatible = "mediatek,zone_movable_cma";
		size = <0 0xffc00000>;
		alignment = <0 0x10000000>;
		alloc-ranges = <0 0xc0000000 1 0x00000000>;
	};
};

/* chosen */
&chosen {
	/* fpga may has no lk, we need to specify display info here */
	/* fb buffer is reserved using this dts by memory node above */

	atag,videolfb-fb_base_l = <0x5e605000>;
	atag,videolfb-fb_base_h = <0x0>;
	atag,videolfb-islcmfound = <1>;
	atag,videolfb-islcm_inited = <0>;
	atag,videolfb-fps= <6000>;
	atag,videolfb-vramSize= <0x017bb000>;
	atag,videolfb-lcmname= "nt51021_wuxga_dsi_vdo_mvk";
};

&odm {
	led0:led@0 {
		compatible = "mediatek,red";
		led_mode = <0>;
		data = <1>;
		pwm_config = <0 0 0 0 0>;
	};
	led1:led@1 {
		compatible = "mediatek,green";
		led_mode = <0>;
		data = <1>;
		pwm_config = <0 0 0 0 0>;
	};
	led2:led@2 {
		compatible = "mediatek,blue";
		led_mode = <0>;
		data = <1>;
		pwm_config = <0 0 0 0 0>;
	};
	led3:led@3 {
		compatible = "mediatek,jogball-backlight";
		led_mode = <0>;
		data = <1>;
		pwm_config = <0 0 0 0 0>;
	};
	led4:led@4 {
		compatible = "mediatek,keyboard-backlight";
		led_mode = <0>;
		data = <1>;
		pwm_config = <0 0 0 0 0>;
	};
	led5:led@5 {
		compatible = "mediatek,button-backlight";
		led_mode = <0>;
		data = <1>;
		pwm_config = <0 0 0 0 0>;
	};
	led6:led@6 {
		compatible = "mediatek,lcd-backlight";
		led_mode = <3>;
		data = <1>;
		pwm_config = <0 1 0 0 0>;
	};
	lcm0:lcm@0 {
		compatible = "novatek,nt51021_mvk";
		gpio_lcm_rst_en = <&pio 39 0>;
		lcm_id0_gpio = <&pio 18 0>;
		lcm_id1_gpio = <&pio 19 0>;
		lcm_rst-supply = <&mt_pmic_vsim1_ldo_reg>;
		lcm_vcc3v3-supply = <&mt_pmic_vpa_buck_reg>;
		pinctrl-names = "default";
		pinctrl-0 = <&lcm_gpio_defalut_cfg>;
		status = "okay";
	};
	lcm1:lcm@1 {
		compatible = "focaltech,ota7290b_mvk";
		gpio_lcm_rst_en = <&pio 39 0>;
		lcm_id0_gpio = <&pio 18 0>;
		lcm_id1_gpio = <&pio 19 0>;
		lcm_rst-supply = <&mt_pmic_vsim1_ldo_reg>;
		lcm_vcc3v3-supply = <&mt_pmic_vpa_buck_reg>;
		pinctrl-names = "default";
		pinctrl-0 = <&lcm_gpio_defalut_cfg>;
		status = "okay";
	};
	lcm_panels {
		lcm-phandle-list = <&lcm0>, <&lcm1>;
		lcm_vendor_id = <0xFF>;
	};
	mt_pmic_customization: mt_pmic_customization@0 {
		compatible = "mediatek,mt-pmic-custom-setting";
		custom-reg = <0x1c1e 0x1 0xf 0x0 /* LDO_VRF18_OP_EN */
			      0x112 0x0 0x1 0x1 /* RTC32k_1V8_1 Enable */
		>;
		disable-modem = <1>;
	};
	/* Hall Sensor */
	hall_sensor:hall {
		compatible = "hall,hall-sensor";
		interrupt-parent = <&pio>;
		interrupts = <5 IRQ_TYPE_LEVEL_LOW 5 0>;
		int-gpio = <&pio 5 0>;
		sensor-name = "hall_sensor_1";
		sensor-num = <1>;
	};

	/* Virtual sensor*/
	/* select_device: Decide to register which thermal_zone device * /
	/* 0: register to thermal_zone16, 1: register to thermal_zone17 */
	virtual_sensor@0 {
		compatible = "amazon,virtual_sensor-thermal";
		dev_id = <0>;
		num_trips = <9>;
		mode = <0>;
		polling_delay = <3000>;
		governor_name = "virtual_sensor";
		num_tbps = <3>;
		temp = <44500 45000 47000 49000 50000 52000 54000 55000 56000 56000 56000 56000>;
		type = <0 0 0 0 0 0 0 0 3 3 3 3>;
		hyst = <0 0 0 0 0 0 0 0 0 0 0 0>;
		num_cdevs = <2>;
		cdev_names = "thermal_budget0","lcd-backlight0";
	};

	virtual_sensor@1 {
		compatible = "amazon,virtual_sensor-thermal";
		dev_id = <1>;
		num_trips = <9>;
		mode = <0>;
		polling_delay = <3000>;
		governor_name = "virtual_sensor";
		num_tbps = <3>;
		temp = <48000 50000 52000 54000 55000 56000 57000 59000 60000 60000 60000 60000>;
		type = <0 0 0 0 0 0 0 0 3 3 3 3>;
		hyst = <0 0 0 0 0 0 0 0 0 0 0 0>;
		num_cdevs = <2>;
		cdev_names = "thermal_budget1","bcct1";
	};

	/*Virtual sensor wmt*/
	thermal_wmt@0 {
		compatible = "amazon,mtkswmt_sensor";
		thermal_wmt,offset = <100>;
		thermal_wmt,offset_invert = <0>;
		thermal_wmt,alpha = <101>;
		thermal_wmt,weight = <0>;
		thermal_wmt,weight_invert = <0>;
		select_device = <0>;
	};
	thermal_wmt@1 {
		compatible = "amazon,mtkswmt_sensor";
		thermal_wmt,offset = <100>;
		thermal_wmt,offset_invert = <0>;
		thermal_wmt,alpha = <101>;
		thermal_wmt,weight = <0>;
		thermal_wmt,weight_invert = <0>;
		select_device = <1>;
	};
	/*Virtual sensor battery*/
	thermal_battery@0 {
		compatible = "amazon,mtksbattery_sensor";
		thermal_battery,offset = <28500>;
		thermal_battery,offset_invert = <1>;
		thermal_battery,alpha = <1000>;
		thermal_battery,weight = <369>;
		thermal_battery,weight_invert = <0>;
		select_device = <0>;
	};

	thermal_battery@1 {
		compatible = "amazon,mtksbattery_sensor";
		thermal_battery,offset = <8020>;
		thermal_battery,offset_invert = <0>;
		thermal_battery,alpha = <448>;
		thermal_battery,weight = <172>;
		thermal_battery,weight_invert = <0>;
		select_device = <1>;
	};

	/*Virtual sensor gpu*/
	thermal_gpu@0 {
		compatible = "amazon,mtksgpu_sensor";
		thermal_gpu,offset = <100>;
		thermal_gpu,offset_invert = <0>;
		thermal_gpu,alpha = <104>;
		thermal_gpu,weight = <0>;
		thermal_gpu,weight_invert = <0>;
		select_device = <0>;
	};

	thermal_gpu@1 {
		compatible = "amazon,mtksgpu_sensor";
		thermal_gpu,offset = <100>;
		thermal_gpu,offset_invert = <0>;
		thermal_gpu,alpha = <104>;
		thermal_gpu,weight = <0>;
		thermal_gpu,weight_invert = <0>;
		select_device = <1>;
	};

	/*Virtual sensor pmic*/
	thermal_pmic@1 {
		compatible = "amazon,mtkspmic_sensor";
		thermal_pmic,offset = <46000>;
		thermal_pmic,offset_invert = <0>;
		thermal_pmic,alpha = <744>;
		thermal_pmic,weight = <65>;
		thermal_pmic,weight_invert = <0>;
		select_device = <1>;
	};

	/*Virtual sensor cpu*/
	thermal_cpu@0 {
		compatible = "amazon,mtkscpu_sensor";
		thermal_cpu,offset = <100>;
		thermal_cpu,offset_invert = <0>;
		thermal_cpu,alpha = <103>;
		thermal_cpu,weight = <0>;
		thermal_cpu,weight_invert = <0>;
		select_device = <0>;
	};
	thermal_cpu@1 {
		compatible = "amazon,mtkscpu_sensor";
		thermal_cpu,offset = <100>;
		thermal_cpu,offset_invert = <0>;
		thermal_cpu,alpha = <103>;
		thermal_cpu,weight = <0>;
		thermal_cpu,weight_invert = <0>;
		select_device = <1>;
	};

	/* Virtual sensor thermistor */
	thermistor@00 {
		compatible = "amazon,virtual_sensor_thermistor";
		thermal_thermistor,offset = <30800>;
		thermal_thermistor,offset_invert = <0>;
		thermal_thermistor,alpha = <1000>;
		thermal_thermistor,weight = <122>;
		thermal_thermistor,weight_invert = <0>;
		aux_channel_num = <0>;
		select_device = <0>;
	};
	thermistor@01 {
		compatible = "amazon,virtual_sensor_thermistor";
		thermal_thermistor,offset = <48600>;
		thermal_thermistor,offset_invert = <0>;
		thermal_thermistor,alpha = <302>;
		thermal_thermistor,weight = <0>;
		thermal_thermistor,weight_invert = <0>;
		aux_channel_num = <0>;
		select_device = <1>;
	};
	thermistor@10 {
		compatible = "amazon,virtual_sensor_thermistor";
		thermal_thermistor,offset = <983>;
		thermal_thermistor,offset_invert = <0>;
		thermal_thermistor,alpha = <1000>;
		thermal_thermistor,weight = <336>;
		thermal_thermistor,weight_invert = <0>;
		aux_channel_num = <1>;
		select_device = <0>;
	};
	thermistor@11 {
		compatible = "amazon,virtual_sensor_thermistor";
		thermal_thermistor,offset = <25600>;
		thermal_thermistor,offset_invert = <1>;
		thermal_thermistor,alpha = <981>;
		thermal_thermistor,weight = <503>;
		thermal_thermistor,weight_invert = <0>;
		aux_channel_num = <1>;
		select_device = <1>;
	};
	thermistor@20 {
		compatible = "amazon,virtual_sensor_thermistor";
		thermal_thermistor,offset = <56500>;
		thermal_thermistor,offset_invert = <0>;
		thermal_thermistor,alpha = <1>;
		thermal_thermistor,weight = <0>;
		thermal_thermistor,weight_invert = <0>;
		aux_channel_num = <2>;
		select_device = <0>;
	};
	thermistor@21 {
		compatible = "amazon,virtual_sensor_thermistor";
		thermal_thermistor,offset = <27300>;
		thermal_thermistor,offset_invert = <0>;
		thermal_thermistor,alpha = <1>;
		thermal_thermistor,weight = <173>;
		thermal_thermistor,weight_invert = <0>;
		aux_channel_num = <2>;
		select_device = <1>;
	};

	/* Battery Current Cooler */
	bcct@0 {
		compatible = "amazon,battery_current_cooler";
		type = "bcct0";
		state = <0>;
		max_state = <12>;
		level = <320001>;
		levels = <320001 320001 320001 320001 320001 320001 320001 320001 320001 320001 320001 320001>;
	};

	bcct@1 {
		compatible = "amazon,battery_current_cooler";
		type = "bcct1";
		state = <0>;
		max_state = <12>;
		level = <320001>;
		levels = <320001 320001 320001 320001 320001 320001 320001 320001 320001 320001 320001 320001>;
	};

	/* Backlight Cooler */
	backlight@0 {
		compatible = "amazon,backlight_cooler";
		type = "lcd-backlight0";
		state = <0>;
		max_state = <12>;
		level = <255>;
		levels = <255 255 255 255 255 255 255 255 255 255 255 255>;
	};

	backlight@1 {
		compatible = "amazon,backlight_cooler";
		type = "lcd-backlight1";
		state = <0>;
		max_state = <12>;
		level = <255>;
		levels = <255 255 255 255 255 255 255 255 255 255 255 255>;
	};

	/* Thermal_budget Cooler */
	thermal_budget@0 {
		compatible = "amazon,thermal_budget_cooler";
		type = "thermal_budget0";
		state = <0>;
		max_state = <12>;
		level = <4600>;
		levels = <4600 4600 4600 4600 4600 4600 4600 4600 4600 4600 4600 4600>;
	};

	thermal_budget@1 {
		compatible = "amazon,thermal_budget_cooler";
		type = "thermal_budget1";
		state = <0>;
		max_state = <12>;
		level = <4600>;
		levels = <4600 4600 4600 4600 4600 4600 4600 4600 4600 4600 4600 4600>;
	};
	/* end of virtual sensor */

#ifndef CONFIG_USER_BUILD
	keycombo@0 {
		compatible = "amzn,keycombo";
		keys_down = "KEY_VOLUMEDOWN", "KEY_VOLUMEUP", "KEY_POWER";
		keys_down_delay = <5000>;
		keys_down_func = <0>;		/* panic */
		status = "okay";
	};
#endif
	keycombo@1 {
		compatible = "amzn,keycombo";
		keys_down = "KEY_POWER";
		keys_down_delay = <6000>;
		keys_down_func = <1>;		/* power off  */
		status = "okay";
	};

	keysilent-ota {
		compatible = "amzn,silent-ota";
		keys_down = "KEY_POWER";
		keys_down_delay = <0>;
		status = "okay";
	};

	integrity-module {
		compatible = "amzn,integrity-module";
		status = "okay";
	};

	/* USB PHY tuning */
	usb_phy_tuning {
		compatible = "mediatek,phy_tuning";
		u2_vrt_ref = <7>;
		u2_term_ref = <6>;
	};
	/* USB PHY tuning end */

	rfc_id {
		compatible = "mediatek,rfc_id_pin";
		rfc_id_pin = <&pio 177 0>;
		pinctrl-names = "default";
		pinctrl-0 = <&rfc_id_pin0_default>;
	};

	ffc_id {
		compatible = "mediatek,ffc_id_pin";
		ffc_id_pin = <&pio 176 0>;
		pinctrl-names = "default";
		pinctrl-0 = <&ffc_id_pin1_default>;
	};
};

&pio {
	/* LCM GPIO Settings - default */
	lcm_gpio_defalut_cfg: lcm_gpio_defalut_cfg {
		pins_cmd_id0 {
			pins = <PINMUX_GPIO18__FUNC_GPIO18>;
			slew-rate = <0>;
			bias-disable;
		};
		pins_cmd_id1 {
			pins = <PINMUX_GPIO19__FUNC_GPIO19>;
			slew-rate = <0>;
			bias-disable;
		};
		pins_cmd_rst {
			pins = <PINMUX_GPIO39__FUNC_GPIO39>;
			slew-rate = <1>;
			output-high;
		};
	};
};

&scp {
	core_1 = "enable";
	scp_sramSize = <0x00080000>;     /* scp_A_sram_size */
};


&mt6370_pmu {
	bled {
		mt,max_bled_brightness = <1370>;
		mt,ignore_initial_bled_brightness = <1>;
	};
};

/* TOUCH start */
&touch {
	tpd-resolution = <1200 1920>;
	use-tpd-button = <0>;
	tpd-key-num = <3>;
	tpd-key-local= <139 172 158 0>;
	tpd-key-dim-local = <90 883 100 40 230 883 100 40 370 883 100 40 0 0 0 0>;
	tpd-max-touch-num = <5>;
	tpd-filter-enable = <1>;
	tpd-filter-pixel-density = <146>;
	tpd-filter-custom-prameters = <0 0 0 0 0 0 0 0 0 0 0 0>;
	tpd-filter-custom-speed = <0 0 0>;
	pinctrl-names = "default", "state_eint_as_int", "state_eint_output0", "state_eint_output1",
		"state_rst_output0", "state_rst_output1";
	pinctrl-0 = <&ctp_pins_default>;
	pinctrl-1 = <&ctp_pins_eint_as_int>;
	pinctrl-2 = <&ctp_pins_eint_output0>;
	pinctrl-3 = <&ctp_pins_eint_output1>;
	pinctrl-4 = <&ctp_pins_rst_output0>;
	pinctrl-5 = <&ctp_pins_rst_output1>;
	vtouch-supply = <&mt_pmic_vldo28_ldo_reg>;
	vtouchio-supply = <&mt_pmic_vrf18_ldo_reg>;
	status = "okay";
};

&i2c0 {
	gt9xx@5d {
		compatible = "goodix,gt9xx";
		reg = <0x5d>;
		vdd_ana-supply = <&mt_pmic_vldo28_ldo_reg>;
		irq-flags = <2>;
		int-gpio = <&pio 1 0x00>;
		rst-gpio = <&pio 2 0x00>;
		touchscreen-max-id = <11>;
		touchscreen-size-x = <1200>;
		touchscreen-size-y = <1920>;
		touchscreen-max-w = <512>;
		touchscreen-max-p = <512>;
		goodix,slide-wakeup = <0>;
		goodix,type-a-report = <0>;
		goodix,driver-send-cfg = <0>;
		goodix,resume-in-workqueue = <0>;
		goodix,int-sync = <1>;
		goodix,swap-x2y = <0>;
		goodix,esd-protect = <1>;
		goodix,auto-update-cfg = <1>;
		goodix,auto-update = <1>;
		goodix,power-off-sleep = <1>;
		goodix,pen-suppress-finger = <0>;
	};
};

&i2c2 {
		#address-cells = <1>;
		#size-cells = <0>;
		clock-frequency = <400000>;
		mediatek,use-open-drain;

		ccu_sensor_i2c_main_hw_mtk:ccu_sensor_i2c_main_hw@33 {
				compatible = "mediatek,ccu_sensor_i2c_main_hw";
				reg = <0x33>;
				status = "okay";
		};

};


&i2c4 {
		#address-cells = <1>;
		#size-cells = <0>;
		clock-frequency = <400000>;
		mediatek,use-open-drain;

		ccu_sensor_i2c_sub_hw_mtk:ccu_sensor_i2c_sub_hw@43 {
				compatible = "mediatek,ccu_sensor_i2c_sub_hw";
				reg = <0x43>;
				status = "okay";
		};

};

&pio {
	ctp_pins_default: eint0default {
		pins_cmd_dat {
			pins = <PINMUX_GPIO1__FUNC_GPIO1>;
			slew-rate = <0>;
			bias-disable;
		};
	};
	ctp_pins_eint_as_int: eint@0 {
		pins_cmd_dat {
			pins = <PINMUX_GPIO1__FUNC_GPIO1>;
			slew-rate = <0>;
			bias-disable;
		};
	};
	ctp_pins_eint_output0: eintoutput0 {
		pins_cmd_dat {
			pins = <PINMUX_GPIO1__FUNC_GPIO1>;
			slew-rate = <1>;
			output-low;
		};
	};
	ctp_pins_eint_output1: eintoutput1 {
		pins_cmd_dat {
			pins = <PINMUX_GPIO1__FUNC_GPIO1>;
			slew-rate = <1>;
			output-high;
		};
	};
	ctp_pins_rst_output0: rstoutput0 {
		pins_cmd_dat {
			pins = <PINMUX_GPIO2__FUNC_GPIO2>;
			slew-rate = <1>;
			output-low;
		};
	};
	ctp_pins_rst_output1: rstoutput1 {
		pins_cmd_dat {
			pins = <PINMUX_GPIO2__FUNC_GPIO2>;
			slew-rate = <1>;
			output-high;
		};
	};
	spi_pins_1: spi1@0{
		pins_spi{
			pinmux = <PINMUX_GPIO161__FUNC_SPI1_A_MI>,
				<PINMUX_GPIO162__FUNC_SPI1_A_CSB>,
				<PINMUX_GPIO163__FUNC_SPI1_A_MO>,
				<PINMUX_GPIO164__FUNC_SPI1_A_CLK>;
			bias-disable;
		};
	};
};
/* TOUCH end */

/* accdet start */
&accdet {
	/* accdet micbias voltage: 0x07,2.7v;0x05,2.5v;0x02,1.9v */
	accdet-mic-vol = <6>;
	headset-mode-setting = <0x500 0x500 1 0x1f0 0x800 0x800 0x20 0x44>;
	accdet-plugout-debounce = <1>;
	/*1:ACC mode, 2:low cost without in bias, 6:low cost with in bias*/
	accdet-mic-mode = <1>;
	/* eint_level_trigger: 8,LEVEL_LOW(default);4,LEVEL_HIGH;others,LEVEL_LOW */
	headset-eint-level-pol = <8>;
	/*0--MD_MAX--UP_MAX--DW_MAX*/
	headset-three-key-threshold = <0 80 220 400>;
	headset-three-key-threshold-CDD = <0 121 192 600>;
	/*0--MD_MAX--VOICE_MAX--UP_MAX--DW_MAX*/
	headset-four-key-threshold = <0 58 121 192 400>;
	/*moisture external resister ohm*/
	moisture-external-r = <2000000>;
	/*moisture internal resister ohm*/
	moisture-internal-r = <47000>;
	/*moisture of water resister ohm*/
	moisture-water-r = <10000>;
	/* ACCDET GPIO standardization ACC mode no use */
	pinctrl-names = "default", "typeswitch_off", "typeswitch_on";
	pinctrl-0 = <&accdet_pins_default>;
	pinctrl-1 = <&aud_pins_ts3a226ae_off>;
	pinctrl-2 = <&aud_pins_ts3a226ae_on>;
	status = "okay";
};
&pio {
	accdet_pins_default: accdetdefault {
		pins_cmd_dat {
			pins = <PINMUX_GPIO166__FUNC_GPIO166>;
			slew-rate = <1>;
			output-low;
		};
	};
	aud_pins_ts3a226ae_off: audts3a226aeoff@1 {
		pins_cmd_dat {
			pins = <PINMUX_GPIO166__FUNC_GPIO166>;
			slew-rate = <1>;
			output-low;
		};
	};
	aud_pins_ts3a226ae_on: audts3a226aeon@2 {
		pins_cmd_dat {
			pins = <PINMUX_GPIO166__FUNC_GPIO166>;
			slew-rate = <1>;
			output-high;
		};
	};
};
/* accdet end */

/* AUDIO GPIO standardization */
&audgpio {
	pinctrl-names = "aud_clk_mosi_off",
			"aud_clk_mosi_on",
			"aud_dat_mosi_off",
			"aud_dat_mosi_on",
			"aud_dat_miso_off",
			"aud_dat_miso_on",
			"aud_smartpa_off",
			"aud_smartpa_on",
			"vow_dat_miso_off",
			"vow_dat_miso_on",
			"vow_clk_miso_off",
			"vow_clk_miso_on",
			"ext_spk_amp_on",
			"ext_spk_amp_off",
			"ext_spk_amp_ctrl0_on",
			"ext_spk_amp_ctrl0_off",
			"ext_hp_amp_on",
			"ext_hp_amp_off",
			"ext_hp_amp_ctrl0_on",
			"ext_hp_amp_ctrl0_off",
			"ext_hp_amp_ctrl1_on",
			"ext_hp_amp_ctrl1_off";
	pinctrl-0 = <&aud_clk_mosi_off>;
	pinctrl-1 = <&aud_clk_mosi_on>;
	pinctrl-2 = <&aud_dat_mosi_off>;
	pinctrl-3 = <&aud_dat_mosi_on>;
	pinctrl-4 = <&aud_dat_miso_off>;
	pinctrl-5 = <&aud_dat_miso_on>;
	pinctrl-6 = <&aud_pins_smartpa_off>;
	pinctrl-7 = <&aud_pins_smartpa_on>;
	pinctrl-8 = <&vow_dat_miso_off>;
	pinctrl-9 = <&vow_dat_miso_on>;
	pinctrl-10 = <&vow_clk_miso_off>;
	pinctrl-11 = <&vow_clk_miso_on>;
	pinctrl-12 = <&ext_spk_amp_on>;
	pinctrl-13 = <&ext_spk_amp_off>;
	pinctrl-14 = <&ext_spk_amp_ctrl0_on>;
	pinctrl-15 = <&ext_spk_amp_ctrl0_off>;
	pinctrl-16 = <&ext_hp_amp_on>;
	pinctrl-17 = <&ext_hp_amp_off>;
	pinctrl-18 = <&ext_hp_amp_ctrl0_on>;
	pinctrl-19 = <&ext_hp_amp_ctrl0_off>;
	pinctrl-20 = <&ext_hp_amp_ctrl1_on>;
	pinctrl-21 = <&ext_hp_amp_ctrl1_off>;
	status = "okay";
};

&pio {
	aud_clk_mosi_off: aud_clk_mosi_off {
		pins_cmd0_dat {
			pins = <PINMUX_GPIO136__FUNC_GPIO136>;
		};
	};

	aud_clk_mosi_on: aud_clk_mosi_on {
		pins_cmd0_dat {
			pins = <PINMUX_GPIO136__FUNC_AUD_CLK_MOSI>;
		};
	};

	aud_dat_mosi_off: aud_dat_mosi_off {
		pins_cmd1_dat {
			pins = <PINMUX_GPIO138__FUNC_GPIO138>;
		};
		pins_cmd2_dat {
			pins = <PINMUX_GPIO139__FUNC_GPIO139>;
		};
	};

	aud_dat_mosi_on: aud_dat_mosi_on {
		pins_cmd1_dat {
			pins = <PINMUX_GPIO138__FUNC_AUD_DAT_MOSI0>;
		};
		pins_cmd2_dat {
			pins = <PINMUX_GPIO139__FUNC_AUD_DAT_MOSI1>;
		};
	};

	aud_dat_miso_off: aud_dat_miso_off {
		pins_cmd1_dat {
			pins = <PINMUX_GPIO142__FUNC_GPIO142>;
		};
		pins_cmd2_dat {
			pins = <PINMUX_GPIO143__FUNC_GPIO143>;
		};
	};

	aud_dat_miso_on: aud_dat_miso_on {
		pins_cmd1_dat {
			pins = <PINMUX_GPIO142__FUNC_AUD_DAT_MISO0>;
		};
		pins_cmd2_dat {
			pins = <PINMUX_GPIO143__FUNC_AUD_DAT_MISO1>;
		};
	};

	aud_pins_smartpa_off: aud_pins_smartpa_off {
		pins_cmd0_dat {
			pins = <PINMUX_GPIO174__FUNC_GPIO174>;
		};
	};

	aud_pins_smartpa_on: aud_pins_smartpa_on {
		pins_cmd0_dat {
			pins = <PINMUX_GPIO174__FUNC_I2S0_DI>;
		};
	};

	extamp_pullhigh: extamp_pullhigh {
		pins_cmd_dat {
			pins = <PINMUX_GPIO0__FUNC_GPIO0>;
			slew-rate = <1>;
			output-high;
		};
	};

	extamp_pulllow: extamp_pulllow {
		pins_cmd_dat {
			pins = <PINMUX_GPIO0__FUNC_GPIO0>;
			slew-rate = <1>;
			output-low;
		};
	};

	vow_dat_miso_off: vow_dat_miso_off {
		pins_cmd1_dat {
			pins = <PINMUX_GPIO142__FUNC_GPIO142>;
		};
	};

	vow_dat_miso_on: vow_dat_miso_on {
		pins_cmd1_dat {
			pins = <PINMUX_GPIO142__FUNC_VOW_DAT_MISO>;
		};
	};

	vow_clk_miso_off: vow_clk_miso_off {
		pins_cmd3_dat {
			pins = <PINMUX_GPIO143__FUNC_GPIO143>;
		};
	};

	vow_clk_miso_on: vow_clk_miso_on {
		pins_cmd3_dat {
			pins = <PINMUX_GPIO143__FUNC_VOW_CLK_MISO>;
		};
	};

	ext_spk_amp_on: ext_spk_amp_on {
		pins_cmd_dat {
			pins = <PINMUX_GPIO151__FUNC_GPIO151>;
			slew-rate = <1>;
			output-high;
		};
	};

	ext_spk_amp_off: ext_spk_amp_off {
		pins_cmd_dat {
			pins = <PINMUX_GPIO151__FUNC_GPIO151>;
			slew-rate = <1>;
			output-low;
		};
	};

	ext_spk_amp_ctrl0_on: ext_spk_amp_ctrl0_on {
		pins_cmd_dat {
			pins = <PINMUX_GPIO150__FUNC_GPIO150>;
			slew-rate = <1>;
			output-high;
		};
	};

	ext_spk_amp_ctrl0_off: ext_spk_amp_ctrl0_off {
		pins_cmd_dat {
			pins = <PINMUX_GPIO150__FUNC_GPIO150>;
			slew-rate = <1>;
			output-low;
		};
	};

	ext_hp_amp_on: ext_hp_amp_on {
		pins_cmd_dat {
			pins = <PINMUX_GPIO153__FUNC_GPIO153>;
			slew-rate = <1>;
			output-high;
		};
	};

	ext_hp_amp_off: ext_hp_amp_off {
		pins_cmd_dat {
			pins = <PINMUX_GPIO153__FUNC_GPIO153>;
			slew-rate = <1>;
			output-low;
		};
	};

	ext_hp_amp_ctrl0_on: ext_hp_amp_ctrl0_on {
		pins_cmd_dat {
			pins = <PINMUX_GPIO175__FUNC_GPIO175>;
			slew-rate = <1>;
			output-high;
		};
	};

	ext_hp_amp_ctrl0_off: ext_hp_amp_ctrl0_off {
		pins_cmd_dat {
			pins = <PINMUX_GPIO175__FUNC_GPIO175>;
			slew-rate = <1>;
			output-low;
		};
	};

	ext_hp_amp_ctrl1_on: ext_hp_amp_ctrl1_on {
		pins_cmd_dat {
			pins = <PINMUX_GPIO179__FUNC_GPIO179>;
			slew-rate = <1>;
			output-high;
		};
	};

	ext_hp_amp_ctrl1_off: ext_hp_amp_ctrl1_off {
		pins_cmd_dat {
			pins = <PINMUX_GPIO179__FUNC_GPIO179>;
			slew-rate = <1>;
			output-low;
		};
	};
};
/* AUDIO end */

/* CONSYS GPIO standardization */
&pio {
	consys_pins_default: consys_default {
	};
	gpslna_pins_init: gpslna@0 {
		pins_cmd_dat {
			pins = <PINMUX_GPIO155__FUNC_GPIO155>;
			slew-rate = <0>;
			bias-disable;
			output-low;
		};
	};
	gpslna_pins_oh: gpslna@1 {
		pins_cmd_dat {
			pins = <PINMUX_GPIO155__FUNC_GPIO155>;
			slew-rate = <1>;
			output-high;
		};
	};
	gpslna_pins_ol: gpslna@2 {
		pins_cmd_dat {
			pins = <PINMUX_GPIO155__FUNC_GPIO155>;
			slew-rate = <1>;
			output-low;
		};
	};
};
&consys {
	pinctrl-names = "default", "gps_lna_state_init", "gps_lna_state_oh", "gps_lna_state_ol";
	pinctrl-0 = <&consys_pins_default>;
	pinctrl-1 = <&gpslna_pins_init>;
	pinctrl-2 = <&gpslna_pins_oh>;
	pinctrl-3 = <&gpslna_pins_ol>;
	status = "okay";
};
/* CONSYS end */

/* CAMERA GPIO standardization */
&pio {
	camera_pins_cam0_rst_0: cam0@0 {
		pins_cmd_dat {
			pins = <PINMUX_GPIO101__FUNC_GPIO101>;
			slew-rate = <1>; /*direction 0:in, 1:out*/
			output-low;/*direction out used only. output_low or high*/
		};
	};
	camera_pins_cam0_rst_1: cam0@1 {
		pins_cmd_dat {
			pins = <PINMUX_GPIO101__FUNC_GPIO101>;
			slew-rate = <1>;
			output-high;
		};
	};
	camera_pins_cam0_pnd_0: cam0@2 {
		pins_cmd_dat {
			pins = <PINMUX_GPIO97__FUNC_GPIO97>;
			slew-rate = <1>;
			output-low;
		};
	};
	camera_pins_cam0_pnd_1: cam0@3 {
		pins_cmd_dat {
			pins = <PINMUX_GPIO97__FUNC_GPIO97>;
			slew-rate = <1>;
			output-high;
		};
	};
	camera_pins_cam1_rst_0: cam1@0 {
		pins_cmd_dat {
			pins = <PINMUX_GPIO102__FUNC_GPIO102>;
			slew-rate = <1>; /*direction 0:in, 1:out*/
			output-low;/*direction out used only. output_low or high*/
		};
	};
	camera_pins_cam1_rst_1: cam1@1 {
		pins_cmd_dat {
			pins = <PINMUX_GPIO102__FUNC_GPIO102>;
			slew-rate = <1>;
			output-high;
		};
	};
	camera_pins_cam1_pnd_0: cam1@2 {
		pins_cmd_dat {
			pins = <PINMUX_GPIO98__FUNC_GPIO98>;
			slew-rate = <1>;
			output-low;
		};
	};
	camera_pins_cam1_pnd_1: cam1@3 {
		pins_cmd_dat {
			pins = <PINMUX_GPIO98__FUNC_GPIO98>;
			slew-rate = <1>;
			output-high;
		};
	};
	camera_pins_cam2_rst_0: cam2@0 {
		pins_cmd_dat {
			pins = <PINMUX_GPIO109__FUNC_GPIO109>;
			slew-rate = <1>;
			output-low;
		};
	};
	camera_pins_cam2_rst_1: cam2@1 {
		pins_cmd_dat {
			pins = <PINMUX_GPIO109__FUNC_GPIO109>;
			slew-rate = <1>;
			output-high;
		};
	};
	camera_pins_cam2_pnd_0: cam2@3 {
		pins_cmd_dat {
			pins = <PINMUX_GPIO107__FUNC_GPIO107>;
			slew-rate = <1>;
			output-low;
		};
	};
	camera_pins_cam2_pnd_1: cam2@4 {
		pins_cmd_dat {
			pins = <PINMUX_GPIO107__FUNC_GPIO107>;
			slew-rate = <1>;
			output-high;
		};
	};
	camera_pins_cam0_vcamd_0: cam0@vcam0 {
		pins_cmd_dat {
			pins = <PINMUX_GPIO91__FUNC_GPIO91>;
			slew-rate = <1>;
			output-low;
		};
	};
	camera_pins_cam0_vcamd_1: cam0@vcam1 {
		pins_cmd_dat {
			pins = <PINMUX_GPIO91__FUNC_GPIO91>;
			slew-rate = <1>;
			output-high;
		};
	};
	camera_pins_cam2_vcamd_0: cam2@vcam0 {
		pins_cmd_dat {
			pins = <PINMUX_GPIO169__FUNC_GPIO169>;
			slew-rate = <1>;
			output-low;
		};
	};
	camera_pins_cam2_vcamd_1: cam1@vcam1 {
		pins_cmd_dat {
			pins = <PINMUX_GPIO169__FUNC_GPIO169>;
			slew-rate = <1>;
			output-high;
		};
	};
	camera_pins_cam2_vcama_0: cam1@vcam2 {
		pins_cmd_dat {
			pins = <PINMUX_GPIO169__FUNC_GPIO169>;
			slew-rate = <1>;
			output-low;
		};
	};
	camera_pins_cam2_vcama_1: cam1@vcam3 {
		pins_cmd_dat {
			pins = <PINMUX_GPIO169__FUNC_GPIO169>;
			slew-rate = <1>;
			output-high;
		};
	};
	camera_pins_cam0_mclk_on: camera_pins_cam0_mclk_on {
		pins_cmd_dat {
			pins = <PINMUX_GPIO99__FUNC_CMMCLK0>;
		};
	};
	camera_pins_cam0_mclk_off: camera_pins_cam0_mclk_off {
		pins_cmd_dat {
			pins = <PINMUX_GPIO99__FUNC_GPIO99>;
		};
	};
	camera_pins_cam1_mclk_off: camera_pins_cam1_mclk_off {
		pins_cmd_dat {
			pins = <PINMUX_GPIO100__FUNC_GPIO100>;
		};
	};
	camera_pins_cam1_mclk_on: camera_pins_cam1_mclk_on {
		pins_cmd_dat {
			pins = <PINMUX_GPIO100__FUNC_CMMCLK1>;
		};
	};
	camera_pins_cam2_mclk_off: camera_pins_cam2_mclk_off {
		pins_cmd_dat {
			pins = <PINMUX_GPIO108__FUNC_GPIO108>;
		};
	};
	camera_pins_cam2_mclk_on: camera_pins_cam2_mclk_on {
		pins_cmd_dat {
			pins = <PINMUX_GPIO108__FUNC_CMMCLK2>;
		};
	};
	camera_pins_default: camdefault {
		/* power down sensor 0 */
		pins_cmd0_rst_dat {
			pins = <PINMUX_GPIO101__FUNC_GPIO101>;
			slew-rate = <1>; /*direction 0:in, 1:out*/
			output-low;/*direction out used only. output_low or high*/
		};
		pins_cmd0_pnd_dat {
			pins = <PINMUX_GPIO97__FUNC_GPIO97>;
			slew-rate = <1>;
			output-high;
		};
		/* power down sensor 1 */
		pins_cmd1_rst_dat {
			pins = <PINMUX_GPIO102__FUNC_GPIO102>;
			slew-rate = <1>; /*direction 0:in, 1:out*/
			output-low;/*direction out used only. output_low or high*/
		};
		pins_cmd1_pnd_dat {
			pins = <PINMUX_GPIO98__FUNC_GPIO98>;
			slew-rate = <1>;
			output-high;
		};
	};
};
&kd_camera_hw1 {
	pinctrl-names = "default",
			"cam0_rst0", "cam0_rst1",
			"cam0_pnd0", "cam0_pnd1",
			"cam1_rst0", "cam1_rst1",
			"cam1_pnd0", "cam1_pnd1",
			"cam2_rst0", "cam2_rst1",
			"cam2_pnd0", "cam2_pnd1",
			"cam_ldo_vcamd_0", "cam_ldo_vcamd_1",
			"cam_ldo_main2_vcamd_0", "cam_ldo_main2_vcamd_1",
			"cam_ldo_main2_vcama_0", "cam_ldo_main2_vcama_1",
			"cam0_mclk_off", "cam0_mclk_on",
			"cam1_mclk_off", "cam1_mclk_on",
			"cam2_mclk_off", "cam2_mclk_on";
	pinctrl-0 = <&camera_pins_default>;
	pinctrl-1 = <&camera_pins_cam0_rst_0>;
	pinctrl-2 = <&camera_pins_cam0_rst_1>;
	pinctrl-3 = <&camera_pins_cam0_pnd_0>;
	pinctrl-4 = <&camera_pins_cam0_pnd_1>;
	pinctrl-5 = <&camera_pins_cam1_rst_0>;
	pinctrl-6 = <&camera_pins_cam1_rst_1>;
	pinctrl-7 = <&camera_pins_cam1_pnd_0>;
	pinctrl-8 = <&camera_pins_cam1_pnd_1>;
	pinctrl-9 = <&camera_pins_cam2_rst_0>;
	pinctrl-10 = <&camera_pins_cam2_rst_1>;
	pinctrl-11 = <&camera_pins_cam2_pnd_0>;
	pinctrl-12 = <&camera_pins_cam2_pnd_1>;
	pinctrl-13 = <&camera_pins_cam0_vcamd_0>;
	pinctrl-14 = <&camera_pins_cam0_vcamd_1>;
	pinctrl-15 = <&camera_pins_cam2_vcamd_0>;
	pinctrl-16 = <&camera_pins_cam2_vcamd_1>;
	pinctrl-17 = <&camera_pins_cam2_vcama_0>;
	pinctrl-18 = <&camera_pins_cam2_vcama_1>;
	pinctrl-19 = <&camera_pins_cam0_mclk_off>;
	pinctrl-20 = <&camera_pins_cam0_mclk_on>;
	pinctrl-21 = <&camera_pins_cam1_mclk_off>;
	pinctrl-22 = <&camera_pins_cam1_mclk_on>;
	pinctrl-23 = <&camera_pins_cam2_mclk_off>;
	pinctrl-24 = <&camera_pins_cam2_mclk_on>;

	status = "okay";
};

/* UART GPIO */
&apuart0 {
	pinctrl-names = "uart0_gpio_default",
			"uart0_rx_set",
			"uart0_rx_clear",
			"uart0_tx_set",
			"uart0_tx_clear";
	pinctrl-0 = <&uart0_gpio_def_cfg>;
	pinctrl-1 = <&uart0_rx_set_cfg>;
	pinctrl-2 = <&uart0_rx_clr_cfg>;
	pinctrl-3 = <&uart0_tx_set_cfg>;
	pinctrl-4 = <&uart0_tx_clr_cfg>;
	status = "okay";
};

&apuart1 {
	status = "disabled";
};

&apuart2 {
	status = "disabled";
};

&pio {
	/* UART GPIO Settings - Start */
	/* UART0: rx set, rx clear, tx clear, tx clear*/
	uart0_gpio_def_cfg:uart0gpiodefault {

	};
	uart0_rx_set_cfg:uart0_rx_set@gpio95 {
		pins_cmd_dat {
			pins = <PINMUX_GPIO95__FUNC_URXD0>;
		};
	};
	uart0_rx_clr_cfg:uart0_rx_clear@gpio95 {
		pins_cmd_dat {
			pins = <PINMUX_GPIO95__FUNC_GPIO95>;
			slew-rate = <1>;
			output-high;
		};
	};
	uart0_tx_set_cfg:uart0_tx_set@gpio96 {
		pins_cmd_dat {
			pins = <PINMUX_GPIO96__FUNC_UTXD0>;
		};
	};
	uart0_tx_clr_cfg:uart0_tx_clear@gpio96 {
		pins_cmd_dat {
			pins = <PINMUX_GPIO96__FUNC_GPIO96>;
			slew-rate = <1>;
			output-high;
		};
	};
};/* UART GPIO end */

/* IRTX GPIO Start */
&irtx_pwm {
	pinctrl-names = "irtx_gpio_led_default", "irtx_gpio_led_set";
	pinctrl-0 = <&irtx_gpio_led_default>;
	pinctrl-1 = <&irtx_gpio_led_set>;
	status = "okay";
};
&pio {
	/* IRTX GPIO Settings -Start */
	/* default: GPIO0, output, high */
	irtx_gpio_led_default:irtx_gpio_led_def@gpio90 {
		pins_cmd_dat {
			pins = <PINMUX_GPIO90__FUNC_GPIO90>;
			slew-rate = <1>;
			bias-disable;
			output-low;
			input-schmitt-enable = <0>;
		};
	};

	irtx_gpio_led_set:irtx_gpio_led_set@gpio90 {
		pins_cmd_dat {
			pins = <PINMUX_GPIO90__FUNC_PWM_A>;
			slew-rate = <1>;
			output-high;
		};
	};
}; /* IRTX GPIO Settings -End */

&main_pmic {
	interrupt-parent = <&pio>;
	interrupts = <182 IRQ_TYPE_LEVEL_HIGH 190 0>;
	status = "okay";
};

&mt6370_pmu {
	mt6370,intr_gpio_num = <10>; /* direct defined GPIO num */
	mt6370,intr_gpio = <&pio 10 0x0>;
};

&mt6370_typec {
	mt6370pd,intr_gpio_num = <41>; /* direct defined GPIO num */
	mt6370pd,intr_gpio = <&pio 41 0x0>;
};

&mt_pmic_vldo28_ldo_reg {
	regulator-name = "vldo28";
	status = "okay";
};

&mt_pmic_vrf18_ldo_reg {
	regulator-name = "vrf18";
	status = "okay";
};

&mt_pmic_vpa_buck_reg {
	regulator-name = "vpa";
	regulator-min-microvolt = <3300000>;
	regulator-max-microvolt = <3300000>;
	regulator-default-on = <2>; /* 0:skip, 1: off, 2:on */
	status = "okay";
};

&mt_pmic_vsim1_ldo_reg {
	regulator-name = "vsim1";
	regulator-min-microvolt = <3100000>;
	regulator-max-microvolt = <3100000>;
	regulator-enable-ramp-delay = <540>;
	regulator-default-on = <2>; /* 0:skip, 1: off, 2:on */
	status = "okay";
};

/* USB TYPEC GPIO start */
&pio {
	usb_default: usb_default {
	};

	gpio_redriver_c1_init: c1_init {
		pins_cmd_dat {
			pins = <PINMUX_GPIO18__FUNC_GPIO18>;
			slew-rate = <1>;
			output-low;
		};
	};

	gpio_redriver_c1_low: c1_low {
		pins_cmd_dat {
			pins = <PINMUX_GPIO18__FUNC_GPIO18>;
			slew-rate = <1>;
			output-low;
		};
	};

	gpio_redriver_c1_hiz: c1_highz {
		pins_cmd_dat {
			pins = <PINMUX_GPIO18__FUNC_GPIO18>;
			slew-rate= <0>;
			bias-disable;
		};
	};

	gpio_redriver_c1_high: c1_high {
		pins_cmd_dat {
			pins = <PINMUX_GPIO18__FUNC_GPIO18>;
			slew-rate = <1>;
			output-high;
		};
	};

	gpio_redriver_c2_init: c2_init {
		pins_cmd_dat {
			pins = <PINMUX_GPIO17__FUNC_GPIO17>;
			slew-rate = <1>;
			output-low;
		};
	};

	gpio_redriver_c2_low: c2_low {
		pins_cmd_dat {
			pins = <PINMUX_GPIO17__FUNC_GPIO17>;
			slew-rate = <1>;
			output-low;
		};
	};

	gpio_redriver_c2_hiz: c2_highz {
		pins_cmd_dat {
			pins = <PINMUX_GPIO17__FUNC_GPIO17>;
			slew-rate= <0>;
			bias-disable;
		};
	};

	gpio_redriver_c2_high: c2_high {
		pins_cmd_dat {
			pins = <PINMUX_GPIO17__FUNC_GPIO17>;
			slew-rate = <1>;
			output-high;
		};
	};

	gpio_u3_switch_sel1: u3_sw_sel1 {
		pins_cmd_dat {
			pins = <PINMUX_GPIO177__FUNC_GPIO177>;
			slew-rate = <1>;
			output-low;
		};
	};

	gpio_u3_switch_sel2: u3_sw_sel2 {
		pins_cmd_dat {
			pins = <PINMUX_GPIO177__FUNC_GPIO177>;
			slew-rate = <1>;
			output-high;
		};
	};

	gpio_u3_switch_enable: u3_sw_en {
	};

	gpio_u3_switch_disable: u3_sw_dis {
	};
};

&usb_c_pinctrl {
	pinctrl-names = "usb_default",
		"redriver_c1_init",
		"redriver_c1_low",
		"redriver_c1_hiz",
		"redriver_c1_high",
		"redriver_c2_init",
		"redriver_c2_low",
		"redriver_c2_hiz",
		"redriver_c2_high",
		"u3_switch_sel1",
		"u3_switch_sel2",
		"u3_switch_enable",
		"u3_switch_disable";

	pinctrl-0 = <&usb_default>;
	pinctrl-1 = <&gpio_redriver_c1_init>;
	pinctrl-2 = <&gpio_redriver_c1_low>;
	pinctrl-3 = <&gpio_redriver_c1_hiz>;
	pinctrl-4 = <&gpio_redriver_c1_high>;
	pinctrl-5 = <&gpio_redriver_c2_init>;
	pinctrl-6 = <&gpio_redriver_c2_low>;
	pinctrl-7 = <&gpio_redriver_c2_hiz>;
	pinctrl-8 = <&gpio_redriver_c2_high>;
	pinctrl-9 = <&gpio_u3_switch_sel1>;
	pinctrl-10 = <&gpio_u3_switch_sel2>;
	pinctrl-11 = <&gpio_u3_switch_enable>;
	pinctrl-12 = <&gpio_u3_switch_disable>;
	status = "okay";

	usb_switch-data {
		en_pin_num = <0>;
		en_pin_val = <0>; /*DISABLE=0 ENABLE=1*/
		sel_pin_num = <177>;
		sel_pin_val = <1>; /*CC1=1, CC2=2*/
		c1_pin_num = <18>;
		c1_pin_val = <2>; /*Low=0, HighZ=1, High=2*/
		c2_pin_num = <17>;
		c2_pin_val = <1>;
	};
};
/* USB TYPEC GPIO end */

&mt_pmic_vcamio_ldo_reg {
	regulator-name = "vcamio";
	regulator-default-on = <1>; /* 0:skip, 1: off, 2:on */
	status = "okay";
};
&mt_pmic_vcama1_ldo_reg {
	regulator-name = "vcama1";
	regulator-min-microvolt = <2800000>;
	regulator-max-microvolt = <2800000>;
	regulator-default-on = <1>; /* 0:skip, 1: off, 2:on */
	status = "okay";
};
&mt_pmic_vcama2_ldo_reg {
	regulator-name = "vcama2";
	regulator-min-microvolt = <2800000>;
	regulator-max-microvolt = <2800000>;
	regulator-default-on = <1>; /* 0:skip, 1: off, 2:on */
	status = "okay";
};

&pio {
	rfc_id_pin0_default: rfc_id_pin_default {
		pins_cmd_dat {
			pinmux = <PINMUX_GPIO177__FUNC_GPIO177>;
			slew-rate = <0>;
			bias-disable;
		};
	};
	ffc_id_pin1_default: ffc_id_pin_default {
		pins_cmd_dat {
			pinmux = <PINMUX_GPIO176__FUNC_GPIO176>;
			slew-rate = <0>;
			bias-disable;
		};
	};
};

/* charger and gauge */
&lk_charger {
	/delete-property/ enable_pe_plus;
	enable_anime;

	/* charging current */
	ac_charger_input_current = <1800000>;
	non_std_ac_charger_current = <1500000>;
	charging_host_charger_current = <1500000>;

	/* battery temperature protection */
	temp_t4_threshold = <55>;
	temp_t3_threshold = <45>;
	temp_t1_threshold = <15>;

	/* T3/T1 charging current */
	temp_t3_input_current = <1800000>;
	temp_t3_charger_current = <2000000>;
	temp_t1_input_current = <1000000>;
	temp_t1_charger_current = <1000000>;
};

&charger {
	/delete-property/ enable_pe_plus;
	/delete-property/ enable_pe_2;
	/delete-property/ enable_pe_3;
	/delete-property/ enable_pe_4;
	/delete-property/ enable_type_c;

	enable_sw_jeita;

	/* common */
	battery_cv = <4350000>;

	ac_charger_input_current = <1800000>;
	charging_host_charger_current = <1500000>;
	non_std_ac_charger_current = <1500000>;

	/* sw jeita */
	jeita_temp_above_t4_cv_voltage = <4100000>;
	jeita_temp_t3_to_t4_cv_voltage = <4100000>;
	jeita_temp_t2_to_t3_cv_voltage = <4350000>;
	jeita_temp_t1_to_t2_cv_voltage = <4350000>;
	jeita_temp_t0_to_t1_cv_voltage = <4350000>;
	jeita_temp_below_t0_cv_voltage = <4350000>;
	temp_t4_threshold = <55>;
	temp_t4_thres_minus_x_degree = <52>;
	temp_t3_threshold = <45>;
	temp_t3_thres_minus_x_degree = <40>;
	temp_t2_threshold = <25>;
	temp_t2_thres_plus_x_degree = <25>;
	temp_t1_threshold = <15>;
	temp_t1_thres_plus_x_degree = <15>;
	temp_t0_threshold = <0>;
	temp_t0_thres_plus_x_degree = <6>;
	temp_neg_10_threshold = <0>;

	temp_t0_charging_current_limit = <600000>;

	/* battery temperature protection */
	enable_min_charge_temperature;
	min_charge_temperature = <0>;
	min_charge_temperature_plus_x_degree = <6>;
	max_charge_temperature = <60>;
	max_charge_temperature_minus_x_degree = <55>;

	top_off_mode_time_threshold = <604800>; /* 7*86400 (7days) */
	top_off_mode_cv = <4100000>; /* CV, uinit:uV */
	top_off_difference_full_cv = <2500>; /* 25% */
	normal_difference_full_cv = <500>; /* 5% */
};
&mt6370_pmu {
	charger {
		safety_timer = <20>;	/* hour */
		ircmp_resistor = <25000>;	/* uohm */
		ircmp_vclamp = <64000>;		/* uV */
		ieoc = <350000>;	/* uA */
	};
};
&bat_gm30 {
	R_FG_VALUE = <(10)>;	/* R_sense resistance. */
	CAR_TUNE_VALUE = <(101)>;	/*	Tune value for current measurement.*/
	MIN_BATTERY_TEMP = <(-10)>;
	#include "bat_setting/mt8183_battery_table_ext_ATL.dtsi"
	#include "bat_setting/mt8183_battery_table_ext_SCUD.dtsi"
};

/ {
	/delete-node/ rt-pd-manager;
};
/* charger and gauge end */

/* SENSOR start */
&i2c1 {
	stk3x1x:stk3x1x@48 {
		compatible = "mediatek,alsps";
		i2c_num = <1>;
		reg = <0x48>;
		i2c_addr = <0x48 0x00 0x00 0x00>;
		polling_mode_ps = <1>;
		polling_mode_als = <1>;
		power_id = <0xffff>;
		power_vol = <0>;
		ps_threshold_high = <120>;
		ps_threshold_low = <100>;
		is_batch_supported_ps = <0>;
		is_batch_supported_als = <0>;
        };

	ltr578:ltr578@53 {
		compatible = "mediatek,ltr578";
		i2c_num = <1>;
		reg = <0x53>;
		i2c_addr = <0x53 0x00 0x00 0x00>;
		polling_mode_ps = <1>;
		polling_mode_als = <1>;
		power_id = <0xffff>;
		power_vol = <0>;
		ps_threshold_high = <120>;
		ps_threshold_low = <100>;
		is_batch_supported_ps = <0>;
		is_batch_supported_als = <0>;
	};

	bma2xx:bma2xx@19{
		compatible = "mediatek,gsensor";
		i2c_num = <1>;
		reg = <0x19>;
		i2c_addr = <0x19 0 0 0>;
		direction = <5>;
		power_id = <0xffff>;
		power_vol = <0>;
		firlen = <0>;
		is_batch_supported = <0>;
	};

	stk8baxx:stk8baxx@18{
		compatible = "mediatek,stk8baxx";
		i2c_num = <1>;
		reg = <0x18>;
		i2c_addr = <0x18 0 0 0>;
		direction = <5>;
		power_id = <0xffff>;
		power_vol = <0>;
		firlen = <0>;
		is_batch_supported = <0>;
	};
};
/* SENSOR end */

/* SD GPIO */
&msdc1 {
	pinctrl-names = "default";
	pinctrl-0 = <&msdc1_pins_sddefault>;
	status = "okay";
};

&pio {
	/* SD GPIO Settings - default */
	msdc1_pins_sddefault: msdc1@sddefault {
		pins_cmd_dat {
			pins = <PINMUX_GPIO3__FUNC_GPIO3>;
			slew-rate = <0>;
			bias-pull-up;
		};
	};
};
/* SD GPIO end */

&i2c3 {
	clock-frequency = <400000>;
	status = "okay";
	lcm_common_i2c@6f {
		compatible = "common,lcm_i2c";
		reg = <0x6f>;
	};
};

&i2c6 {
	rt551x: audio-codec@57 {
		compatible = "realtek,rt551x";
		#sound-dai-cells = <0>;
		reg = <0x57>;
		interrupt-parent = <&pio>;
		interrupts = <169 IRQ_TYPE_LEVEL_HIGH 169 0>;
		rt5518-reset = <&pio 178 0>;
		hw_analog_gain = <0xe>;
		hw_digital_gain = <0x8927>;
		pinctrl-names = "default", "rt551x_hwreset_enable",
				"rt551x_hwreset_disable";
		pinctrl-0 = <&rt551x_default>;
		pinctrl-1 = <&rt551x_hwreset_enable>;
		pinctrl-2 = <&rt551x_hwreset_disable>;
	};
};

&pio {
	rt551x_default: rt551x_default {
		pins_cmd_dat {
			pins = <PINMUX_GPIO178__FUNC_GPIO178>;
			slew-rate = <1>;
			output-high;
		};
	};
	rt551x_hwreset_enable: rt551x_hwreset_enable {
		pins_cmd_dat {
			pins = <PINMUX_GPIO178__FUNC_GPIO178>;
			slew-rate = <1>;
			output-low;
		};
	};
	rt551x_hwreset_disable: rt551x_hwreset_disable {
		pins_cmd_dat {
			pins = <PINMUX_GPIO178__FUNC_GPIO178>;
			slew-rate = <1>;
			output-high;
		};
	};
};

&spi1 {
	pinctrl-names = "default";
	pinctrl-0 = <&spi_pins_1>;
	mediatek,pad-select = <0>;
	status = "okay";
	/* clients */
	rt551x_spi: audio-codec@0 {
		compatible = "realtek,rt551x";
		reg = <0x0>;
		spi-max-frequency = <18000000>;
	};
};

&audio {
	channel-type = <0>; /* 0(Stereo) 1(MonoLeft) 2(MonoRight) */
	sound-dai = <&rt551x>;
};

&disp_aal0 {
	aal_support = <0>;
};

/* KPD */
/* overwite cust.dtsi settings generated from maverick.dws */
&keypad {
	mediatek,kpd-key-debounce = <1024>;
	mediatek,kpd-sw-pwrkey = <116>;
	mediatek,kpd-hw-pwrkey = <8>;
	mediatek,kpd-sw-rstkey  = <0>;
	mediatek,kpd-hw-rstkey = <17>;
	mediatek,kpd-use-extend-type = <0>;
	/*HW Keycode [0~71] -> Linux Keycode*/
	mediatek,kpd-hw-map-num = <72>;
	mediatek,kpd-hw-init-map = <115 114 0 0 0 0 0 0 0 0 0 0 0 0 0 0 0 0 0 0 0 0 0 0
			0 0 0 0 0 0 0 0 0 0 0 0 0 0 0 0 0 0 0 0 0 0 0 0
			0 0 0 0 0 0 0 0 0 0 0 0 0 0 0 0 0 0 0 0 0 0 0 0 >;
	mediatek,kpd-pwrkey-eint-gpio = <0>;
	mediatek,kpd-pwkey-gpio-din  = <0>;
	mediatek,kpd-hw-recovery-key = <0>;
	mediatek,kpd-hw-fastboot-key = <1>;
	/delete-property/mediatek,kpd-hw-dl-key2;
	status = "okay";
};
/* KPD end */
&led6 {
	brightness-normalize-enable = <1>;
	chosen-id = <>;
	brightness-normalize-count = <4>;
	brightness-normalize-table = <
				/* <panel-id base scale def> */
				0 389 413 89 /*INX*/
				1 389 389 89 /*BOE*/
				2 389 418 89 /*KD(CPT)*/
				3 389 418 89 /*KD(INX)*/ >;
};
/*End of this file, DO NOT ADD ANYTHING HERE*/
